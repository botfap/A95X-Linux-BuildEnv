## buildroot/package/opengl/Config.in
```kconfig
source "package/opengl/libgl/Config.in"
source "package/opengl/libegl/Config.in"
source "package/opengl/libgles/Config.in"
source "package/opengl/libopenvg/Config.in"
source "package/opengl/libopenmax/Config.in"

config BR2_PACKAGE_OPENGL
	bool "opengl"
    select BR2_PACKAGE_HAS_LIBGLES
    select BR2_PACKAGE_HAS_LIBEGL
	help
	  amlogic mali400 opengl driver.

	  http://openlinux.amlogic.com

config BR2_PACKAGE_OPENGL_MALI_VERSION
    string "mali version"

config BR2_PACKAGE_OPENGL_VERSION
    string "mali opengl version"

config BR2_PACKAGE_PROVIDES_LIBEGL
	default "opengl" if BR2_PACKAGE_OPENGL

config BR2_PACKAGE_PROVIDES_LIBGLES
	default "opengl" if BR2_PACKAGE_OPENGL
```

## buildroot/package/opengl/src/driver/Kconfig
```kconfig
menu "Mali GPU OpenGL device driver"
config MALI400
	tristate "Mali-300/400/450 support"
	depends on ARM
	depends on m
	default m
	select DMA_SHARED_BUFFER
	---help---
	  This enables support for the ARM Mali-300, Mali-400, and Mali-450
	  GPUs.

	  To compile this driver as a module, choose M here: the module will be
	  called mali.

config MALI400_DEBUG
	bool "Enable debug in Mali driver"
	depends on MALI400
	---help---
	  This enabled extra debug checks and messages in the Mali driver.

if !PROFILING || !FTRACE
comment "ARM mali streamline with gator is depends on CONFIG_FTRACE and PROFILING.I will"
comment "select them and other options for you.please refer to ARM DS-5 Documentation."
comment "Setting up an ARM Linux target"
endif

config MALI400_PROFILING
	bool "Enable Mali profiling"
	depends on MALI400
	select PROFILING
	select FTRACE
	select MALI400_DEBUG
	select PERF_EVENTS
	select ENABLE_DEFAULT_TRACERS
	select DEBUG_MUTEXES
	select HIGH_RES_TIMERS
	select HW_PERF_EVENTS
	select CPU_FREQ
	select TRACEPOINTS
	---help---
	  This enables gator profiling of Mali GPU events.

config MALI400_INTERNAL_PROFILING
	bool "Enable internal Mali profiling API"
	depends on MALI400_PROFILING
	default n
	---help---
	  This enables the internal legacy Mali profiling API.

config MALI400_UMP
	bool "Enable UMP support"
	depends on MALI400
	---help---
	  This enables support for the UMP memory sharing API in the Mali driver.
	  
config MALI400_OS_MEMORY_SIZE
	depends on MALI400
	int "OS Memory Size(MB)"
	range 64 2048
	default 384
	---help---
	  The size of mali OS memory with unit of mega byte.
	  
if ARCH_MESON6TV
config MALI400_4_PP
       bool "Mali 400 for M6TV With 4 pp core."
       depends on MALI400
       ---help---
         M6TV Lite only have 4 mali pp cores.
endif
	  
endmenu
```

## buildroot/package/python-sphinx/Config.in
```kconfig
config BR2_PACKAGE_PYTHON_SPHINX
	bool "python-sphinx"
	depends on BR2_PACKAGE_PYTHON
	help
	  python sphinx plugin
```

## buildroot/package/remotecfg/Config.in
```kconfig
config BR2_PACKAGE_REMOTECFG
        bool "remotecfg"
        help
          amlogic remote config tool.

          http://openlinux.amlogic.com
```

## buildroot/package/rtk8188eu/Config.in
```kconfig
config BR2_PACKAGE_RTK8188EU
	bool "rtk8188eu"
	depends on BR2_LINUX_KERNEL	
	help
	  rtk8188eu driver

config BR2_PACKAGE_RTK8188EU_GIT_VERSION
	string "rtk8188eu branch"
	depends on BR2_PACKAGE_RTK8188EU
	help
		Branch for rtk8188eu	

config BR2_PACKAGE_RTK8188EU_GIT_REPO_URL
	string "rtk8188eu git"
	depends on BR2_PACKAGE_RTK8188EU
	help
		rtk8188eu git

config BR2_PACKAGE_RTK8188EU_STANDALONE
	bool "standalone kernel module"
	depends on BR2_PACKAGE_RTK8188EU
	help
	  compile ko directly
```

## buildroot/package/rtk8189es/Config.in
```kconfig
config BR2_PACKAGE_RTK8189ES
	bool "rtk8189es"
	depends on BR2_LINUX_KERNEL	
	help
	  rtk8189es driver

config BR2_PACKAGE_RTK8189ES_GIT_VERSION
	string "rtk8189es branch"
	depends on BR2_PACKAGE_RTK8189ES
	help
		Branch for rtk8189es	

config BR2_PACKAGE_RTK8189ES_GIT_REPO_URL
	string "rtk8189es git"
	depends on BR2_PACKAGE_RTK8189ES
	help
		rtk8189es git

config BR2_PACKAGE_RTK8189ES_STANDALONE
	bool "standalone kernel module"
	depends on BR2_PACKAGE_RTK8189ES
	help
	  compile ko directly
```

## buildroot/package/rtk8189ftv/Config.in
```kconfig
config BR2_PACKAGE_RTK8189FTV
	bool "rtk8189ftv"
	depends on BR2_LINUX_KERNEL	
	help
	  rtk8189ftv driver

config BR2_PACKAGE_RTK8189FTV_GIT_VERSION
	string "rtk8189ftv branch"
	depends on BR2_PACKAGE_RTK8189FTV
	help
		Branch for rtk8189ftv

config BR2_PACKAGE_RTK8189FTV_GIT_REPO_URL
	string "rtk8189ftv git"
	depends on BR2_PACKAGE_RTK8189FTV
	help
		rtk8189ftv git

config BR2_PACKAGE_RTK8189FTV_STANDALONE
	bool "standalone kernel module"
	depends on BR2_PACKAGE_RTK8189FTV
	help
	  compile ko directly
```

## buildroot/package/rtk8192cu/Config.in
```kconfig
config BR2_PACKAGE_RTK8192CU
	bool "rtk8192cu"
	depends on BR2_LINUX_KERNEL	
	help
	  rtk8192cu driver

config BR2_PACKAGE_RTK8192CU_GIT_VERSION
	string "rtk8192cu branch"
	depends on BR2_PACKAGE_RTK8192CU
	help
		Branch for rtk8192cu	

config BR2_PACKAGE_RTK8192CU_GIT_REPO_URL
	string "rtk8192cu git"
	depends on BR2_PACKAGE_RTK8192CU
	help
		rtk8192cu git

config BR2_PACKAGE_RTK8192CU_STANDALONE
	bool "standalone kernel module"
	depends on BR2_PACKAGE_RTK8192CU
	help
	  compile ko directly
```

## buildroot/package/rtk8192du/Config.in
```kconfig
config BR2_PACKAGE_RTK8192DU
	bool "rtk8192du"
	depends on BR2_LINUX_KERNEL	
	help
	  rtk8192du driver

config BR2_PACKAGE_RTK8192DU_GIT_VERSION
	string "rtk8192du branch"
	depends on BR2_PACKAGE_RTK8192DU
	help
		Branch for rtk8192du	

config BR2_PACKAGE_RTK8192DU_GIT_REPO_URL
	string "rtk8192du git"
	depends on BR2_PACKAGE_RTK8192DU
	help
		rtk8192du git
```

## buildroot/package/rtk8192es/Config.in
```kconfig
config BR2_PACKAGE_RTK8192ES
	bool "rtk8192es"
	depends on BR2_LINUX_KERNEL	
	help
	  rtk8192es driver

config BR2_PACKAGE_RTK8192ES_GIT_VERSION
	string "rtk8192es branch"
	depends on BR2_PACKAGE_RTK8192ES
	help
		Branch for rtk8192es	

config BR2_PACKAGE_RTK8192ES_GIT_REPO_URL
	string "rtk8192es git"
	depends on BR2_PACKAGE_RTK8192ES
	help
		rtk8192es git

config BR2_PACKAGE_RTK8192ES_STANDALONE
	bool "standalone kernel module"
	depends on BR2_PACKAGE_RTK8192ES
	help
	  compile ko directly
```

## buildroot/package/rtk8192eu/Config.in
```kconfig
config BR2_PACKAGE_RTK8192EU
	bool "rtk8192eu"
	depends on BR2_LINUX_KERNEL	
	help
	  rtk8192eu driver

config BR2_PACKAGE_RTK8192EU_GIT_VERSION
	string "rtk8192eu branch"
	depends on BR2_PACKAGE_RTK8192EU
	help
		Branch for rtk8192eu	

config BR2_PACKAGE_RTK8192EU_GIT_REPO_URL
	string "rtk8192eu git"
	depends on BR2_PACKAGE_RTK8192EU
	help
		rtk8192eu git

config BR2_PACKAGE_RTK8192EU_STANDALONE
	bool "standalone kernel module"
	depends on BR2_PACKAGE_RTK8192EU
	help
	  compile ko directly
```

## buildroot/package/rtk8723au/Config.in
```kconfig
config BR2_PACKAGE_RTK8723AU
	bool "rtk8723au"
	depends on BR2_LINUX_KERNEL	
	help
	  rtk8723au driver

config BR2_PACKAGE_RTK8723AU_GIT_VERSION
	string "rtk8723au branch"
	depends on BR2_PACKAGE_RTK8723AU
	help
		Branch for rtk8723au

config BR2_PACKAGE_RTK8723AU_GIT_REPO_URL
	string "rtk8723au git"
	depends on BR2_PACKAGE_RTK8723AU
	help
		rtk8723au git
```

## buildroot/package/rtk8723bs/Config.in
```kconfig
config BR2_PACKAGE_RTK8723BS
	bool "rtk8723bs"
	depends on BR2_LINUX_KERNEL	
	help
	  rtk8723bs driver

config BR2_PACKAGE_RTK8723BS_GIT_VERSION
	string "rtk8723bs branch"
	depends on BR2_PACKAGE_RTK8723BS
	help
		Branch for rtk8723bs

config BR2_PACKAGE_RTK8723BS_GIT_REPO_URL
	string "rtk8723bs git"
	depends on BR2_PACKAGE_RTK8723BS
	help
		rtk8723bs git

config BR2_PACKAGE_RTK8723BS_STANDALONE
	bool "standalone kernel module"
	depends on BR2_PACKAGE_RTK8723BS
	help
	  compile ko directly
```

## buildroot/package/rtk8723bu/Config.in
```kconfig
config BR2_PACKAGE_RTK8723BU
	bool "rtk8723bu"
	depends on BR2_LINUX_KERNEL	
	help
	  rtk8723bu driver

config BR2_PACKAGE_RTK8723BU_GIT_VERSION
	string "rtk8723bu branch"
	depends on BR2_PACKAGE_RTK8723BU
	help
		Branch for rtk8723bu

config BR2_PACKAGE_RTK8723BU_GIT_REPO_URL
	string "rtk8723bu git"
	depends on BR2_PACKAGE_RTK8723BU
	help
		rtk8723bu git

config BR2_PACKAGE_RTK8723BU_STANDALONE
	bool "standalone kernel module"
	depends on BR2_PACKAGE_RTK8723BU
	help
	  compile ko directly
```

## buildroot/package/rtk8811au/Config.in
```kconfig
config BR2_PACKAGE_RTK8811AU
	bool "rtk8811au"
	depends on BR2_LINUX_KERNEL	
	help
	  rtk8811au driver

config BR2_PACKAGE_RTK8811AU_GIT_VERSION
	string "rtk8811au branch"
	depends on BR2_PACKAGE_RTK8811AU
	help
		Branch for rtk8811au	

config BR2_PACKAGE_RTK8811AU_GIT_REPO_URL
	string "rtk8811au git"
	depends on BR2_PACKAGE_RTK8811AU
	help
		rtk8811au git
```

## buildroot/package/rtk8812au/Config.in
```kconfig
config BR2_PACKAGE_RTK8812AU
	bool "rtk8812au"
	depends on BR2_LINUX_KERNEL	
	help
	  rtk8812au driver

config BR2_PACKAGE_RTK8812AU_GIT_VERSION
	string "rtk8812au branch"
	depends on BR2_PACKAGE_RTK8812AU
	help
		Branch for rtk8812au	

config BR2_PACKAGE_RTK8812AU_GIT_REPO_URL
	string "rtk8812au git"
	depends on BR2_PACKAGE_RTK8812AU
	help
		rtk8812au git

config BR2_PACKAGE_RTK8812AU_STANDALONE
	bool "standalone kernel module"
	depends on BR2_PACKAGE_RTK8812AU
	help
	  compile ko directly
```

## buildroot/package/rtk8822bu/Config.in
```kconfig
config BR2_PACKAGE_RTK8822BU
	bool "rtk8822bu"
	depends on BR2_LINUX_KERNEL	
	help
	  rtk8822bu driver

config BR2_PACKAGE_RTK8822BU_GIT_VERSION
	string "rtk8822bu branch"
	depends on BR2_PACKAGE_RTK8822BU
	help
		Branch for rtk8822bu	

config BR2_PACKAGE_RTK8822BU_GIT_REPO_URL
	string "rtk8822bu git"
	depends on BR2_PACKAGE_RTK8822BU
	help
		rtk8822bu git

config BR2_PACKAGE_RTK8822BU_STANDALONE
	bool "standalone kernel module"
	depends on BR2_PACKAGE_RTK8822BU
	help
	  compile ko directly
```

## buildroot/package/shairport/Config.in
```kconfig
config BR2_PACKAGE_SHAIRPORT
	bool "shairport"
	select BR2_PACKAGE_ALSA_LIB
	select BR2_PACKAGE_OPENSSL
	select BR2_PACKAGE_AVAHI
	help
	  This program emulates an AirPort Express for the purpose of streaming music from iTunes and compatible
	  iPods and iPhones. It implements a server for the Apple RAOP protocol. ShairPort does not support
          AirPlay v2 (video and photo streaming).
```

## buildroot/package/ump_userspace_drv/Config.in
```kconfig
config BR2_PACKAGE_UMP_USERSPACE_DRV
        bool "ump user space driver"
	select BR2_PACKAGE_GPU
        help
          ump user space driver from arm.
```

## buildroot/package/wifi-fw/Config.in
```kconfig
config BR2_PACKAGE_WIFI_FW
	bool "wifi-fw"
	depends on BR2_LINUX_KERNEL	
	help
	  WIFI-FW contains all the firmware for the wifi modules that amlogic supports.

config BR2_PACKAGE_WIFI_CUSTOM_GIT_VERSION
	string "wifi fw branch"
	depends on BR2_PACKAGE_WIFI_FW
	help
		Branch for Wifi FW	

config BR2_PACKAGE_WIFI_FW_CUSTOM_GIT_REPO_URL
	string "wifi fw git"
	depends on BR2_PACKAGE_WIFI_FW
	help
		Wifi fw git

config BR2_PACKAGE_WIFI_FW_WIFI_MODULE
    string "wifi module"
	depends on BR2_PACKAGE_WIFI_FW
	help
		Wifi module 
```

## buildroot/package/x11r7/xdriver_xf86-video-mali/Config.in
```kconfig
config BR2_PACKAGE_XDRIVER_XF86_VIDEO_MALI
	bool "xf86-video-mali"
	select BR2_PACKAGE_XPROTO_FONTSPROTO
	select BR2_PACKAGE_XPROTO_RANDRPROTO
	select BR2_PACKAGE_XPROTO_RENDERPROTO
	select BR2_PACKAGE_XPROTO_VIDEOPROTO
	select BR2_PACKAGE_XPROTO_XPROTO
	help
	  ARM framebuffer device
```
