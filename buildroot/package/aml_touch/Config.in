## buildroot/package/aml_touch/Config.in
```kconfig
config BR2_PACKAGE_AML_TOUCH
	bool "aml touch"
	depends on BR2_LINUX_KERNEL	
	help
	  touch driver

config BR2_PACKAGE_AML_TOUCH_GIT_VERSION
	string "touch branch"
	depends on BR2_PACKAGE_AML_TOUCH
	help
		Branch for touch

config BR2_PACKAGE_AML_TOUCH_GIT_REPO_URL
	string "touch git"
	depends on BR2_PACKAGE_AML_TOUCH
	help
		touch git
```

## buildroot/package/aml_tvin/Config.in
```kconfig
config BR2_PACKAGE_AML_TVIN
	bool "amltvin"
	depends on BR2_LINUX_KERNEL	
	help
	  tvin driver

config BR2_PACKAGE_AML_TVIN_GIT_VERSION
	string "tvin branch"
	depends on BR2_PACKAGE_AML_TVIN
	help
		Branch for tvin

config BR2_PACKAGE_AML_TVIN_GIT_REPO_URL
	string "tvin git"
	depends on BR2_PACKAGE_AML_TVIN
	help
		tvin git
```

## buildroot/package/aml_uboot_customer/Config.in
```kconfig
config BR2_PACKAGE_AML_UBOOT_CUSTOMER
	bool "amlogic uboot customer"
	help

config BR2_PACKAGE_AML_UBOOT_CUSTOMER_GIT_VERSION
    string "amlogic uboot customer branch"
    help
        uboot customer branch
config BR2_PACKAGE_AML_UBOOT_CUSTOMER_GIT_REPO_URL
    string "amlogic uboot customer repo"
    help
        uboot customer repo 
```

## buildroot/package/aml_util/Config.in
```kconfig
config BR2_PACKAGE_AML_UTIL
	bool "aml utilities"
	depends on BR2_LINUX_KERNEL	
	help
	  utilities
```

## buildroot/package/amlogic_test/Config.in
```kconfig
config BR2_PACKAGE_AMLOGIC_TEST
	bool "Amlogic Test"
	select BR2_PACKAGE_STRESSAPPTEST
	help
	    amlogic testing scripts and programs
```

## buildroot/package/autotest-client-tests/Config.in
```kconfig
config BR2_PACKAGE_AUTOTEST_CLIENT_TESTS
	bool "autotest-client-tests"
	help
        Autotest client tests.
```

## buildroot/package/autotest/Config.in
```kconfig
config BR2_PACKAGE_AUTOTEST
	bool "autotest"
	select BR2_PACKAGE_PYTHON 
	select BR2_PACKAGE_PYTHON_SPHINX
    select BR2_PACKAGE_PYTHON_UNICODEDATA
    select BR2_PACKAGE_PYTHON_ZLIB
    select BR2_PACKAGE_AUTOTEST_CLIENT_TESTS
	help
        Autotest is a framework for fully automated testing.
```

## buildroot/package/brcmap6xxx/Config.in
```kconfig
config BR2_PACKAGE_BRCMAP6XXX
	bool "brcmap6xxx"
	depends on BR2_LINUX_KERNEL	
	help
	  brcmap6xxx driver

config BR2_PACKAGE_BRCMAP6XXX_GIT_VERSION
	string "brcmap6xxx branch"
	depends on BR2_PACKAGE_BRCMAP6XXX
	help
		Branch for brcmap6xxx	

config BR2_PACKAGE_BRCMAP6XXX_GIT_REPO_URL
	string "brcmap6xxx git"
	depends on BR2_PACKAGE_BRCMAP6XXX
	help
		brcmap6xxx git

config BR2_PACKAGE_BRCMAP6XXX_STANDALONE
	bool "standalone kernel module"
	depends on BR2_PACKAGE_BRCMAP6XXX
	help
	  compile ko directly
```

## buildroot/package/brcmusi/Config.in
```kconfig
config BR2_PACKAGE_BRCMUSI
	bool "brcmusi"
	depends on BR2_LINUX_KERNEL	
	help
	  brcm dhd driver

config BR2_PACKAGE_BRCMUSI_GIT_VERSION
	string "brcm usi branch"
	depends on BR2_PACKAGE_BRCMUSI
	help
		Branch for brcm usi

config BR2_PACKAGE_BRCMUSI_GIT_REPO_URL
	string "brcm usi git"
	depends on BR2_PACKAGE_BRCMUSI
	help
		brcm usi git
```

## buildroot/package/gpu/Config.in
```kconfig
config BR2_PACKAGE_GPU
	bool "amlogic gpu driver git repo"
	depends on BR2_LINUX_KERNEL	
	help
	  The git of amlogic gpu driver git repo

config BR2_PACKAGE_GPU_VERSION
	string "amlogic gpu branch" 
	depends on BR2_PACKAGE_GPU
	help
	  the branch of amlogic gpu driver

config BR2_PACKAGE_GPU_GIT_URL
	string "amlogic gpu driver git repo url"
	depends on BR2_PACKAGE_GPU
	help
	  the URL of amlogic gpu driver git repo

config BR2_PACKAGE_GPU_CUSTOM_TARBALL_LOCATION
	string "amlogic gpu driver tarball url"
	depends on BR2_PACKAGE_GPU
	help
	  the URL of amlogic gpu driver

config BR2_PACKAGE_GPU_STANDALONE
	bool "standalone kernel module"
	depends on BR2_PACKAGE_GPU
	help
	  compile ko directly
config BR2_PACKAGE_GPU_UMP
	bool "enable ump"
	depends on BR2_PACKAGE_GPU
	help
	  enable ump on standalone ko
config BR2_PACKAGE_GPU_MALI_DRM
	bool "enable mali_drm"
	depends on BR2_PACKAGE_GPU
	help
	  build mali_drm.ko
config BR2_PACKAGE_GPU_MALI_DMA_SHARED_BUFFER
	bool "enable mali dma shared buffer"
	depends on BR2_PACKAGE_GPU
	help
	  enable shared buffer
```

## buildroot/package/libcares/Config.in
```kconfig
config BR2_PACKAGE_LIBCARES
	bool "libcares"
	help
	  a C library for asynchronous DNS requests (including name resolves)

	  http://c-ares.haxx.se/
```

## buildroot/package/libdlna/Config.in
```kconfig
config BR2_PACKAGE_LIBDLNA
	bool "libdlna"
    select BR2_PACKAGE_LIBUPNP
    select BR2_PACKAGE_AML_LIBS
    select BR2_PACKAGE_LIBPLAYER
	help
        libdlna aims at being the reference open-source implementation of DLNA (Digital Living Network Alliance) standards. Its primary goal is to provide DLNA support to uShare, an embedded DLNA & UPnP A/V Media Server, but it will be used to build both DLNA servers and players in the long term.
        libdlna is written in C and relies on FFMPEG librairies (libavformat and libavcodec) to handle and demux A/V streams. You still need libupnp to provide basic UPnP support to your project.
        libdlna is based on official DLNA specifications and aims at providing a complete respect of the defined standards. Right now, libdlna can be used to build compliant DLNA Media Servers.
        libdlna is free software - it is licensed under the terms of the GNU Lesser General Public License (GNU/LGPL) version 2.1+. 

comment "libdlna needs a toolchain w/ largefile, threads"
	depends on !(BR2_LARGEFILE && BR2_TOOLCHAIN_HAS_THREADS)
```

## buildroot/package/mali_examples/Config.in
```kconfig
config BR2_PACKAGE_MALI_EXAMPLES
	bool "mali examples"
	help
	  Test examples for Mali OpenGL ES.
```

## buildroot/package/mtk7601/Config.in
```kconfig
config BR2_PACKAGE_MTK7601
	bool "mtk7601"
	depends on BR2_LINUX_KERNEL	
	help
	  mtk7601 driver

config BR2_PACKAGE_MTK7601_GIT_VERSION
	string "mtk7601 branch"
	depends on BR2_PACKAGE_MTK7601
	help
		Branch for mtk7601

config BR2_PACKAGE_MTK7601_GIT_REPO_URL
	string "mtk7601 git"
	depends on BR2_PACKAGE_MTK7601
	help
		mtk7601 git
```

## buildroot/package/mtk7603/Config.in
```kconfig
config BR2_PACKAGE_MTK7603
	bool "mtk7603"
	depends on BR2_LINUX_KERNEL	
	help
	  mtk7603 driver

config BR2_PACKAGE_MTK7603_GIT_VERSION
	string "mtk7603 branch"
	depends on BR2_PACKAGE_MTK7603
	help
		Branch for mtk7603

config BR2_PACKAGE_MTK7603_GIT_REPO_URL
	string "mtk7603 git"
	depends on BR2_PACKAGE_MTK7603
	help
		mtk7603 git
```

## buildroot/package/multimedia/Config.in
```kconfig
menu "Audio and video applications"
source "package/multimedia/alsa-plugins/Config.in"
source "package/multimedia/amaudio/Config.in"
source "package/multimedia/audiocapture/Config.in"
source "package/multimedia/mediasupport/Config.in"

# Gstreamer 0.10.x & Plugins
source "package/multimedia/gst-fluendo-mpegdemux/Config.in"
source "package/multimedia/gst-aml-plugins/Config.in"
source "package/multimedia/gst-aml-plugins1/Config.in"
source "package/multimedia/gst-app/Config.in"
#source "package/multimedia/aml_libs/Config.in"

source "package/multimedia/libplayer/Config.in"
source "package/multimedia/wifidisplay/Config.in"
endmenu
```

## buildroot/package/multimedia/amaudio/Config.in
```kconfig
config BR2_PACKAGE_AMAUDIO
        bool "amaudio"
        help
          amlogic audio process.

          http://openlinux.amlogic.com
```

## buildroot/package/multimedia/aml_libs/Config.in
```kconfig
config BR2_PACKAGE_AML_LIBS
        bool "aml_libs"
        help
          amlogic media player library.

          http://openlinux.amlogic.com
```

## buildroot/package/multimedia/audiocapture/Config.in
```kconfig
config BR2_PACKAGE_AUDIOCAPTURE
        bool "audiocapture"
        help
          amlogic audio capture process.

          http://openlinux.amlogic.com
```

## buildroot/package/multimedia/gst-aml-plugins/Config.in
```kconfig
config BR2_PACKAGE_GST_AML_PLUGINS
        bool "gst-aml-plugins"
        depends on BR2_PACKAGE_GSTREAMER 
        help
	  Amlogic GStreamer plugins to send audio es to aml dsp and video es to aml hw decoder. decode and render will be complete
	  at kernel level.
```

## buildroot/package/multimedia/gst-aml-plugins1/Config.in
```kconfig
config BR2_PACKAGE_GST_AML_PLUGINS1
        bool "gst-aml-plugins1"
        depends on BR2_PACKAGE_GSTREAMER1 
        depends on BR2_PACKAGE_LIBPLAYER
        help
	  Amlogic GStreamer1 plugins 1.0 to send audio es to aml dsp and video es to aml hw decoder. decode and render will be complete
	  at kernel level.
```

## buildroot/package/multimedia/gst-app/Config.in
```kconfig
config BR2_PACKAGE_GST_APP
        bool "gst-app"
#        depends on BR2_PACKAGE_AML_PLUGINS 
        help
	  GStreamer players demo
```

## buildroot/package/multimedia/libplayer/Config.in
```kconfig
config BR2_PACKAGE_LIBPLAYER
        bool "libplayer"
	select BR2_PACKAGE_ALSA_LIB
        select BR2_PACKAGE_ZLIB        
        help
          amlogic media player library.

          http://openlinux.amlogic.com
```

## buildroot/package/multimedia/mediasupport/Config.in
```kconfig
config BR2_PACKAGE_MEDIASUPPORT
        bool "mediasupport"
        help
          amlogic media support process.

          http://openlinux.amlogic.com
```

## buildroot/package/multimedia/wifidisplay/Config.in
```kconfig
config BR2_PACKAGE_WIFIDISPLAY
        bool "wifidisplay"
        help
          amlogic wifidisplay library.

config BR2_PACKAGE_WIFIDISPLAY_DEMO
		bool "wifidisplay_demo"
	    depends on BR2_PACKAGE_WIFIDISPLAY
		default y
		help
		  amlogic wifidisplay demo
```
