## buildroot/package/aml_af_alg/Config.in
```kconfig
config BR2_PACKAGE_AML_AF_ALG
	bool "aml_af_alog"
        depends on BR2_PACKAGE_OPENSSL
	help
          Openssl af_alg engine modified by Amlogic
          http://src.carnivore.it/users/common/af_alg/about/

config BR2_PACKAGE_AML_AF_ALG_VERSION
	string "amlogic af_alg branch" 
	depends on BR2_PACKAGE_AML_AF_ALG
	help
	  the branch of amlogic af_alg

config BR2_PACKAGE_AML_AF_ALG_GIT_URL
	string "amlogic af_alg git url"
	depends on BR2_PACKAGE_AML_AF_ALG
	help
	  the URL of amlogic af_alg git
```

## buildroot/package/aml_bdk/Config.in
```kconfig
config BR2_PACKAGE_AML_BDK
    bool "amlogic trust zone"
    depends on BR2_LINUX_KERNEL
    help
        Trustzone 
```

## buildroot/package/aml_customer/Config.in
```kconfig
config BR2_PACKAGE_AML_CUSTOMER
	bool "amlogic customer git repo"
	help
	  The git of amlogic customer git repo

config BR2_PACKAGE_AML_CUSTOMER_VERSION
	string "amlogic customer branch" 
	depends on BR2_PACKAGE_AML_CUSTOMER
	help
	  the branch of amlogic customer

config BR2_PACKAGE_AML_CUSTOMER_GIT_URL
	string "amlogic customer git repo url"
	depends on BR2_PACKAGE_AML_CUSTOMER
	help
	  the URL of amlogic customer git repo
```

## buildroot/package/aml_img_packer_new/Config.in.host
```kconfig
config BR2_PACKAGE_HOST_AML_IMG_PACKER_NEW
	bool "host new aml image packer"
	help
```

## buildroot/package/aml_nand/Config.in
```kconfig
config BR2_PACKAGE_AML_NAND
	bool "amlogic Nand FTL"
	help
	  amlogic Nand FTL support

config BR2_PACKAGE_AML_NAND_VERSION
	string "amlogic nand branch" 
	depends on BR2_PACKAGE_AML_NAND
	help
	  the branch of amlogic nand

config BR2_PACKAGE_AML_NAND_GIT_URL
	string "amlogic nand git url"
	depends on BR2_PACKAGE_AML_NAND
	help
	  the URL of amlogic nand git

config BR2_PACKAGE_AML_NAND_STANDALONE
	bool "standalone kernel module"
	depends on BR2_PACKAGE_AML_NAND
	help
	  compile ko directly
```

## buildroot/package/aml_pmu/Config.in
```kconfig
config BR2_PACKAGE_AML_PMU
	bool "aml pmu"
	depends on BR2_LINUX_KERNEL	
	help
	  pmu driver

config BR2_PACKAGE_AML_PMU_GIT_VERSION
	string "pmu branch"
	depends on BR2_PACKAGE_AML_PMU
	help
		Branch for pmu

config BR2_PACKAGE_AML_PMU_GIT_REPO_URL
	string "pmu git"
	depends on BR2_PACKAGE_AML_PMU
	help
		pmu git
```

## buildroot/package/aml_thermal/Config.in
```kconfig
comment "aml_thermal needs a Linux kernel to be built"
	depends on !BR2_LINUX_KERNEL

config BR2_PACKAGE_AML_THERMAL
	depends on BR2_LINUX_KERNEL
	bool "aml thermal control"
	help
		aml thermal control

config BR2_PACKAGE_AML_THERMAL_URL
	depends on BR2_PACKAGE_AML_THERMAL
	string "aml thermal url"
	help
		aml thermal url

config BR2_PACKAGE_AML_THERMAL_VERSION
	depends on BR2_PACKAGE_AML_THERMAL
	string "aml thermal version"
	help
		aml thermal version
```
