## buildroot/configs/meson6tv_yahoo_defconfig
```kconfig
# Mirrors and Download locations
BR2_BACKUP_SITE="http://openlinux.amlogic.com:8000/download/GPL_code_release/ThirdParty"
BR2_arm=y
BR2_cortex_a9=y
BR2_ARM_ENABLE_NEON=y
BR2_ARM_FPU_NEON=y
BR2_DEPRECATED=y
BR2_TOOLCHAIN_EXTERNAL=y
BR2_TOOLCHAIN_EXTERNAL_LINARO_ARM201204=y
BR2_PACKAGE_HOST_GDB=y
BR2_ROOTFS_DEVICE_CREATION_DYNAMIC_MDEV=y
BR2_ROOTFS_OVERLAY="board/amlogic/meson_mt/rootfs/"
BR2_PACKAGE_AML_CUSTOMER=y
BR2_PACKAGE_AML_CUSTOMER_VERSION="master"
BR2_PACKAGE_AML_CUSTOMER_GIT_URL="git://git-sc.amlogic.com/kernel/customer"
BR2_PACKAGE_ALSA_UTILS=y
BR2_PACKAGE_ALSA_UTILS_ALSACONF=y
BR2_PACKAGE_ALSA_UTILS_AMIXER=y
BR2_PACKAGE_ALSA_UTILS_APLAY=y
BR2_PACKAGE_AUDIOCAPTURE=y
BR2_PACKAGE_MEDIASUPPORT=y
BR2_PACKAGE_GSTREAMER=y
BR2_PACKAGE_GST_PLUGINS_BASE_PLUGIN_ALSA=y
BR2_PACKAGE_GST_PLUGINS_GOOD=y
BR2_PACKAGE_GST_PLUGINS_GOOD_PLUGIN_AUDIOPARSERS=y
BR2_PACKAGE_GST_PLUGINS_GOOD_PLUGIN_AUTODETECT=y
BR2_PACKAGE_GST_PLUGINS_GOOD_PLUGIN_ID3DEMUX=y
BR2_PACKAGE_GST_PLUGINS_GOOD_PLUGIN_ISOMP4=y
BR2_PACKAGE_GST_PLUGINS_GOOD_PLUGIN_MATROSKA=y
BR2_PACKAGE_GST_PLUGINS_GOOD_PLUGIN_SOUPHTTPSRC=y
BR2_PACKAGE_GST_PLUGINS_GOOD_PLUGIN_WAVPACK=y
BR2_PACKAGE_GST_PLUGINS_BAD=y
BR2_PACKAGE_GST_PLUGINS_BAD_PLUGIN_H264PARSE=y
BR2_PACKAGE_GST_PLUGINS_BAD_PLUGIN_ID3TAG=y
BR2_PACKAGE_GST_PLUGINS_BAD_PLUGIN_MPEGDEMUX=y
BR2_PACKAGE_GST_PLUGINS_BAD_PLUGIN_MPEGTSDEMUX=y
BR2_PACKAGE_GST_PLUGINS_BAD_PLUGIN_DIRECTFB=y
BR2_PACKAGE_GST_PLUGINS_UGLY=y
BR2_PACKAGE_GST_PLUGINS_UGLY_PLUGIN_ASFDEMUX=y
BR2_PACKAGE_GST_PLUGINS_UGLY_PLUGIN_MPEGAUDIOPARSE=y
BR2_PACKAGE_GST_PLUGINS_UGLY_PLUGIN_MAD=y
BR2_PACKAGE_GST_FLUENDO_MPEGDEMUX=y
BR2_PACKAGE_GST_AML_PLUGINS=y
BR2_PACKAGE_GST_APP=y
BR2_PACKAGE_AML_LIBS=y
BR2_PACKAGE_LIBPLAYER=y
BR2_PACKAGE_GDB=y
BR2_PACKAGE_GDB_SERVER=y
BR2_PACKAGE_GDB_DEBUGGER=y
BR2_PACKAGE_FBDUMP=y
BR2_PACKAGE_FBGRAB=y
BR2_PACKAGE_FBTERM=y
BR2_PACKAGE_FB_TEST_APP=y
BR2_PACKAGE_UTIL_LINUX_BINARIES=y
BR2_PACKAGE_E2FSPROGS=y
BR2_PACKAGE_OPENSSL=y
BR2_PACKAGE_CAIRO_SCRIPT=y
BR2_PACKAGE_LIBJPEG=y
BR2_PACKAGE_OPENGL=y
BR2_PACKAGE_PANGO=y
BR2_PACKAGE_REMOTECFG=y
BR2_PACKAGE_LIBCARES=y
BR2_PACKAGE_LIBCURL=y
BR2_PACKAGE_BOOST=y
BR2_PACKAGE_LIBEVENT=y
BR2_PACKAGE_ICU=y
BR2_PACKAGE_CJSON=y
BR2_PACKAGE_LIBXSLT=y
BR2_PACKAGE_DHCPCD=y
BR2_PACKAGE_DNSMASQ=y
# BR2_PACKAGE_DNSMASQ_TFTP is not set
# BR2_PACKAGE_DNSMASQ_DHCP is not set
BR2_PACKAGE_IW=y
BR2_PACKAGE_NTP=y
BR2_PACKAGE_NTP_NTPDATE=y
BR2_PACKAGE_NTP_NTPDC=y
BR2_PACKAGE_WPA_SUPPLICANT=y
BR2_PACKAGE_WPA_SUPPLICANT_CLI=y
BR2_PACKAGE_KMOD=y
BR2_TARGET_ROOTFS_CPIO=y
BR2_TARGET_ROOTFS_EXT2=y
BR2_TARGET_ROOTFS_EXT2_4=y
BR2_TARGET_ROOTFS_TAR_GZIP=y
BR2_LINUX_KERNEL=y
BR2_LINUX_KERNEL_CUSTOM_GIT=y
BR2_LINUX_KERNEL_CUSTOM_REPO_URL="gituser@git-sc.amlogic.com:kernel/common.git"
BR2_LINUX_KERNEL_CUSTOM_REPO_VERSION="amlogic-3.0"
BR2_LINUX_KERNEL_PATCH="linux/amlogic-3.0"
BR2_LINUX_KERNEL_DEFCONFIG="meson6tv_h101"
BR2_TARGET_BOARD_PLATFORM="meson6"
BR2_PACKAGE_GPU=y
BR2_PACKAGE_GPU_VERSION="r3p2-EAC"
BR2_PACKAGE_GPU_GIT_URL="git://git-sc.amlogic.com/platform/hardware/arm/gpu.git"
BR2_PACKAGE_OPENGL_MALI_VERSION="m400"
BR2_PACKAGE_WIFI_FW=y
BR2_PACKAGE_WIFI_CUSTOM_GIT_VERSION="jb-mr1-amlogic"
BR2_PACKAGE_WIFI_FW_CUSTOM_GIT_REPO_URL="git://git.myamlogic.com/platform/hardware/amlogic/wifi.git"
BR2_PACKAGE_WIFI_FW_WIFI_MODULE="AP6210"
BR2_PACKAGE_AML_NAND=n
BR2_PACKAGE_AML_NAND_VERSION="amlogic-nand"
BR2_PACKAGE_AML_NAND_GIT_URL="git://git.myamlogic.com/platform/hardware/amlogic/nand.git"
```

## buildroot/configs/meson6tvd_3.10_h13_x_defconfig
```kconfig
# Mirrors and Download locations
BR2_BACKUP_SITE="http://openlinux.amlogic.com:8000/download/GPL_code_release/ThirdParty"
BR2_arm=y
BR2_cortex_a9=y
BR2_ARM_ENABLE_NEON=y
BR2_ARM_FPU_NEON=y
BR2_DEPRECATED=y
BR2_TOOLCHAIN_EXTERNAL=y
BR2_TOOLCHAIN_EXTERNAL_LINARO_ARM201204=y
BR2_ROOTFS_DEVICE_CREATION_DYNAMIC_EUDEV=y
BR2_ROOTFS_OVERLAY="board/amlogic/meson_h13_x/rootfs"
BR2_PACKAGE_AML_CUSTOMER=y
BR2_PACKAGE_AML_CUSTOMER_VERSION="master"
BR2_PACKAGE_AML_CUSTOMER_GIT_URL="git://git.myamlogic.com/kernel/customer.git"
BR2_PACKAGE_AML_UTIL=y
BR2_PACKAGE_ALSA_UTILS=y
BR2_PACKAGE_ALSA_UTILS_ALSACONF=y
BR2_PACKAGE_ALSA_UTILS_AMIXER=y
BR2_PACKAGE_ALSA_UTILS_APLAY=y
BR2_PACKAGE_GSTREAMER=y
BR2_PACKAGE_GST_PLUGINS_BASE_PLUGIN_ALSA=y
BR2_PACKAGE_GST_PLUGINS_GOOD=y
BR2_PACKAGE_GST_PLUGINS_GOOD_PLUGIN_AUDIOPARSERS=y
BR2_PACKAGE_GST_PLUGINS_GOOD_PLUGIN_AUTODETECT=y
BR2_PACKAGE_GST_PLUGINS_GOOD_PLUGIN_ID3DEMUX=y
BR2_PACKAGE_GST_PLUGINS_GOOD_PLUGIN_ISOMP4=y
BR2_PACKAGE_GST_PLUGINS_GOOD_PLUGIN_MATROSKA=y
BR2_PACKAGE_GST_PLUGINS_GOOD_PLUGIN_SOUPHTTPSRC=y
BR2_PACKAGE_GST_PLUGINS_GOOD_PLUGIN_WAVPACK=y
BR2_PACKAGE_GST_PLUGINS_BAD=y
BR2_PACKAGE_GST_PLUGINS_BAD_PLUGIN_H264PARSE=y
BR2_PACKAGE_GST_PLUGINS_BAD_PLUGIN_ID3TAG=y
BR2_PACKAGE_GST_PLUGINS_BAD_PLUGIN_MPEGDEMUX=y
BR2_PACKAGE_GST_PLUGINS_BAD_PLUGIN_MPEGTSDEMUX=y
BR2_PACKAGE_GST_PLUGINS_BAD_PLUGIN_DIRECTFB=y
BR2_PACKAGE_GST_PLUGINS_UGLY=y
BR2_PACKAGE_GST_PLUGINS_UGLY_PLUGIN_ASFDEMUX=y
BR2_PACKAGE_GST_PLUGINS_UGLY_PLUGIN_MPEGAUDIOPARSE=y
BR2_PACKAGE_GST_PLUGINS_UGLY_PLUGIN_MAD=y
BR2_PACKAGE_GST_FLUENDO_MPEGDEMUX=y
BR2_PACKAGE_GST_AML_PLUGINS=y
BR2_PACKAGE_GST_APP=y
BR2_PACKAGE_AML_LIBS=y
BR2_PACKAGE_LIBPLAYER=y
BR2_PACKAGE_MPLAYER=y
# BR2_PACKAGE_DIRECTFB_PS2MOUSE is not set
# BR2_PACKAGE_DIRECTFB_SERIALMOUSE is not set
# BR2_PACKAGE_DIRECTFB_TSLIB is not set
BR2_PACKAGE_DIRECTFB_TESTS=y
BR2_PACKAGE_FBDUMP=y
BR2_PACKAGE_FB_TEST_APP=y
BR2_PACKAGE_UTIL_LINUX_BINARIES=y
BR2_PACKAGE_LIBDRM=y
BR2_PACKAGE_LIBDRI2=y
BR2_PACKAGE_XORG7=y
BR2_PACKAGE_XSERVER_XORG_SERVER=y
BR2_PACKAGE_XSERVER_XORG_SERVER_MODULAR=y
BR2_PACKAGE_XLIB_LIBXCOMPOSITE=y
BR2_PACKAGE_XAPP_XCLOCK=y
BR2_PACKAGE_XAPP_XEDIT=y
BR2_PACKAGE_XAPP_XLOGO=y
BR2_PACKAGE_XDRIVER_XF86_INPUT_EVDEV=y
BR2_PACKAGE_XDRIVER_XF86_INPUT_KEYBOARD=y
BR2_PACKAGE_XDRIVER_XF86_INPUT_MOUSE=y
BR2_PACKAGE_XDRIVER_XF86_VIDEO_FBDEV=y
BR2_PACKAGE_XDRIVER_XF86_VIDEO_FBTURBO=y
BR2_PACKAGE_XDRIVER_XF86_VIDEO_MALI=y
BR2_PACKAGE_XPROTO_XF86DRIPROTO=y
BR2_PACKAGE_XPROTO_DRI2PROTO=y
BR2_PACKAGE_LUA=y
BR2_PACKAGE_LUA_5_1=y
BR2_PACKAGE_EFL=y
BR2_PACKAGE_ENLIGHTENMENT=y
BR2_PACKAGE_MIDORI=y
BR2_PACKAGE_XTERM=y
BR2_PACKAGE_EUDEV_RULES_GEN=y
BR2_PACKAGE_LIBJPEG=y
BR2_PACKAGE_LIBGTK2=y
BR2_PACKAGE_OPENGL=y
BR2_PACKAGE_OPENGL_MALI_VERSION="m450-X"
BR2_PACKAGE_REMOTECFG=y
BR2_PACKAGE_LIBSOUP_SSL=y
BR2_PACKAGE_DHCPCD=y
BR2_PACKAGE_IW=y
BR2_PACKAGE_NTP=y
# BR2_PACKAGE_NTP_NTPD is not set
BR2_PACKAGE_NTP_NTPDATE=y
BR2_PACKAGE_WPA_SUPPLICANT=y
BR2_PACKAGE_WPA_SUPPLICANT_CLI=y
BR2_PACKAGE_HOST_E2FSPROGS=y
BR2_PACKAGE_HOST_GENEXT2FS=y
BR2_TARGET_ROOTFS_TAR_GZIP=y
BR2_LINUX_KERNEL=y
BR2_LINUX_KERNEL_CUSTOM_GIT=y
BR2_LINUX_KERNEL_CUSTOM_REPO_URL="git://git.myamlogic.com/kernel/common.git"
BR2_LINUX_KERNEL_CUSTOM_REPO_VERSION="amlogic-3.10-bringup"
BR2_LINUX_KERNEL_DEFCONFIG="meson6tvd"
BR2_TARGET_BOARD_PLATFORM="meson6"
BR2_LINUX_KERNEL_DTS_SUPPORT=y
BR2_LINUX_KERNEL_INTREE_DTS_NAME="meson6tvd_ref"
BR2_LINUX_KERNEL_AMLOGIC_DTD=y
BR2_LINUX_KERNEL_AMLOGIC_DTD_STRIP=y
BR2_LINUX_KERNEL_ANDROID_FORMAT=y
BR2_PACKAGE_GPU_VERSION="r5p1"
BR2_PACKAGE_GPU_GIT_URL="git://git.myamlogic.com/platform/hardware/arm/gpu.git"
#BR2_PACKAGE_UMP_USERSPACE_DRV=y
BR2_PACKAGE_WIFI_FW=y
BR2_PACKAGE_WIFI_CUSTOM_GIT_VERSION="kk-amlogic"
BR2_PACKAGE_WIFI_FW_CUSTOM_GIT_REPO_URL="git://git.myamlogic.com/platform/hardware/amlogic/wifi.git"
BR2_PACKAGE_RTK8188EU=y
BR2_PACKAGE_RTK8188EU_GIT_VERSION="8188eu"
BR2_PACKAGE_RTK8188EU_GIT_REPO_URL="git://git.myamlogic.com/platform/hardware/wifi/realtek/drivers/8188eu.git"
BR2_PACKAGE_RTK8192CU=y
BR2_PACKAGE_RTK8192CU_GIT_VERSION="8192cu"
BR2_PACKAGE_RTK8192CU_GIT_REPO_URL="git://git.myamlogic.com/platform/hardware/wifi/realtek/drivers/8192cu.git"
BR2_PACKAGE_RTK8192DU=y
BR2_PACKAGE_RTK8192DU_GIT_VERSION="8192du"
BR2_PACKAGE_RTK8192DU_GIT_REPO_URL="git://git.myamlogic.com/platform/hardware/wifi/realtek/drivers/8192du.git"
BR2_PACKAGE_RTK8192EU=y
BR2_PACKAGE_RTK8192EU_GIT_VERSION="8192eu"
BR2_PACKAGE_RTK8192EU_GIT_REPO_URL="git://git.myamlogic.com/platform/hardware/wifi/realtek/drivers/8192eu.git"
BR2_PACKAGE_BRCMAP6XXX=y
BR2_PACKAGE_BRCMAP6XXX_GIT_VERSION="ap6xxx"
BR2_PACKAGE_BRCMAP6XXX_GIT_REPO_URL="git://git.myamlogic.com/platform/hardware/wifi/broadcom/drivers/ap6xxx.git"
BR2_PACKAGE_AML_TVIN=y
BR2_PACKAGE_AML_TVIN_GIT_VERSION="amlogic-3.10-bringup"
BR2_PACKAGE_AML_TVIN_GIT_REPO_URL="git://git.myamlogic.com/linux/amlogic/tvin.git"
```

## buildroot/configs/meson6tvd_3.10_player_defconfig
```kconfig
# Mirrors and Download locations
BR2_BACKUP_SITE="http://openlinux.amlogic.com:8000/download/GPL_code_release/ThirdParty"
BR2_arm=y
BR2_cortex_a9=y
BR2_ARM_ENABLE_NEON=y
BR2_ARM_FPU_NEON=y
BR2_TOOLCHAIN_EXTERNAL=y
BR2_ROOTFS_DEVICE_CREATION_DYNAMIC_MDEV=y
BR2_ROOTFS_OVERLAY="board/amlogic/meson_h13/rootfs"
BR2_LINUX_KERNEL=y
BR2_LINUX_KERNEL_CUSTOM_GIT=y
BR2_LINUX_KERNEL_CUSTOM_REPO_URL="git://git.myamlogic.com/kernel/common.git"
BR2_LINUX_KERNEL_CUSTOM_REPO_VERSION="amlogic-3.10-bringup"
BR2_LINUX_KERNEL_DEFCONFIG="meson6tvd"
BR2_TARGET_BOARD_PLATFORM="meson6"
BR2_LINUX_KERNEL_DTS_SUPPORT=y
BR2_LINUX_KERNEL_INTREE_DTS_NAME="meson6tvd_ref"
BR2_LINUX_KERNEL_AMLOGIC_DTD=y
BR2_LINUX_KERNEL_AMLOGIC_DTD_STRIP=y
BR2_LINUX_KERNEL_ANDROID_FORMAT=y
BR2_PACKAGE_GPU=y
BR2_PACKAGE_GPU_VERSION="r5p1"
BR2_PACKAGE_GPU_GIT_URL="git://git.myamlogic.com/platform/hardware/arm/gpu.git"
BR2_PACKAGE_WIFI_FW=y
BR2_PACKAGE_WIFI_CUSTOM_GIT_VERSION="kk-amlogic"
BR2_PACKAGE_WIFI_FW_CUSTOM_GIT_REPO_URL="git://git.myamlogic.com/platform/hardware/amlogic/wifi.git"
BR2_PACKAGE_RTK8188EU=y
BR2_PACKAGE_RTK8188EU_GIT_VERSION="8188eu"
BR2_PACKAGE_RTK8188EU_GIT_REPO_URL="git://git.myamlogic.com/platform/hardware/wifi/realtek/drivers/8188eu.git"
BR2_PACKAGE_RTK8192CU=y
BR2_PACKAGE_RTK8192CU_GIT_VERSION="8192cu"
BR2_PACKAGE_RTK8192CU_GIT_REPO_URL="git://git.myamlogic.com/platform/hardware/wifi/realtek/drivers/8192cu.git"
BR2_PACKAGE_RTK8192DU=y
BR2_PACKAGE_RTK8192DU_GIT_VERSION="8192du"
BR2_PACKAGE_RTK8192DU_GIT_REPO_URL="git://git.myamlogic.com/platform/hardware/wifi/realtek/drivers/8192du.git"
BR2_PACKAGE_RTK8192EU=y
BR2_PACKAGE_RTK8192EU_GIT_VERSION="8192eu"
BR2_PACKAGE_RTK8192EU_GIT_REPO_URL="git://git.myamlogic.com/platform/hardware/wifi/realtek/drivers/8192eu.git"
BR2_PACKAGE_AML_TVIN=y
BR2_PACKAGE_AML_TVIN_GIT_VERSION="amlogic-3.10-bringup"
BR2_PACKAGE_AML_TVIN_GIT_REPO_URL="git://git.myamlogic.com/linux/amlogic/tvin.git"
BR2_PACKAGE_AML_CUSTOMER=y
BR2_PACKAGE_AML_CUSTOMER_VERSION="master"
BR2_PACKAGE_AML_CUSTOMER_GIT_URL="git://git.myamlogic.com/kernel/customer.git"
BR2_PACKAGE_AML_UTIL=y
BR2_PACKAGE_AML_LIBS=y
BR2_PACKAGE_LIBPLAYER=y
BR2_PACKAGE_FBDUMP=y
BR2_PACKAGE_FB_TEST_APP=y
BR2_PACKAGE_UTIL_LINUX_BINARIES=y
BR2_PACKAGE_MALI_EXAMPLES=y
BR2_PACKAGE_OPENGL=y
BR2_PACKAGE_OPENGL_MALI_VERSION="m450"
BR2_PACKAGE_REMOTECFG=y
BR2_PACKAGE_DHCPCD=y
BR2_PACKAGE_NTP=y
# BR2_PACKAGE_NTP_NTPD is not set
BR2_PACKAGE_NTP_NTPDATE=y
BR2_PACKAGE_WPA_SUPPLICANT=y
BR2_PACKAGE_WPA_SUPPLICANT_CLI=y
BR2_TARGET_ROOTFS_TAR_GZIP=y
BR2_PACKAGE_HOST_E2FSPROGS=y
BR2_PACKAGE_HOST_GENEXT2FS=y
```
