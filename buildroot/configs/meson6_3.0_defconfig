## buildroot/configs/meson6_3.0_defconfig
```kconfig
# Mirrors and Download locations
BR2_BACKUP_SITE="http://openlinux.amlogic.com:8000/download/GPL_code_release/ThirdParty"
# Architecture
BR2_arm=y
BR2_cortex_a9=y
#
# Target options
#

#Tool chain
BR2_TOOLCHAIN_EXTERNAL=y
#BR2_TOOLCHAIN_EXTERNAL_CODESOURCERY_ARM2010Q1=y
BR2_TOOLCHAIN_EXTERNAL_CUSTOM=y
BR2_TOOLCHAIN_EXTERNAL_PREINSTALLED=y
BR2_TOOLCHAIN_EXTERNAL_CUSTOM_PREFIX="arm-none-linux-gnueabi"
BR2_TOOLCHAIN_EXTERNAL_PATH="/opt/CodeSourcery/Sourcery_G++_Lite/"
BR2_TOOLCHAIN_EXTERNAL_PREFIX="arm-none-linux-gnueabi"
BR2_TOOLCHAIN_EXTERNAL_GLIBC=y
BR2_TOOLCHAIN_EXTERNAL_CUSTOM_GLIBC=y
BR2_TOOLCHAIN_EXTERNAL_CXX=y
#GDB option
BR2_LARGEFILE=y
BR2_INET_IPV6=y
BR2_INET_RPC=y
BR2_USE_WCHAR=y
BR2_ENABLE_LOCALE=y
BR2_INSTALL_LIBSTDCPP=y
BR2_TOOLCHAIN_HAS_THREADS=y
BR2_TOOLCHAIN_HAS_THREADS_DEBUG=y
BR2_TOOLCHAIN_HAS_THREADS_DEBUG_IF_NEEDED=y
BR2_TOOLCHAIN_HAS_SHADOW_PASSWORDS=y
BR2_USE_MMU=y
BR2_PREFER_SOFT_FLOAT=y
BR2_SOFT_FLOAT=y

#rootfs Image
BR2_TARGET_ROOTFS_CPIO=y
BR2_TARGET_ROOTFS_CPIO_NONE=y
BR2_TARGET_ROOTFS_INITRAMFS=y

#                                                                               
# Kernel                                                                    
#                                                                           
BR2_LINUX_KERNEL=y                                                                                         
BR2_LINUX_KERNEL_CUSTOM_GIT=y                                               
BR2_LINUX_KERNEL_CUSTOM_REPO_URL="git://scgit.amlogic.com/kernel/common"
BR2_LINUX_KERNEL_CUSTOM_REPO_VERSION="amlogic-3.0"                           
BR2_LINUX_KERNEL_USE_DEFCONFIG=y                                                                       
BR2_LINUX_KERNEL_DEFCONFIG="meson6_skt"
BR2_TARGET_BOARD_PLATFORM="meson6"                                     
BR2_LINUX_KERNEL_UIMAGE=y 

#
# amlogic customer
#
BR2_PACKAGE_AML_CUSTOMER=y
BR2_PACKAGE_AML_CUSTOMER_VERSION="master"
BR2_PACKAGE_AML_CUSTOMER_GIT_URL="git://scgit.amlogic.com/kernel/customer"


BR2_PACKAGE_DIRECTFB=y
BR2_PACKAGE_AML_NAND=y
BR2_PACKAGE_AML_NAND_VERSION="amlogic-nand"
BR2_PACKAGE_AML_NAND_GIT_URL="git://git.myamlogic.com/platform/hardware/amlogic/nand.git"
```

## buildroot/configs/meson6_3.0_g18_defconfig
```kconfig
# Mirrors and Download locations
BR2_BACKUP_SITE="http://openlinux.amlogic.com:8000/download/GPL_code_release/ThirdParty"
# Architecture
BR2_arm=y
BR2_cortex_a9=y
BR2_ARM_ENABLE_NEON=y
BR2_ARM_FPU_NEON=y
BR2_DEPRECATED=y
BR2_TOOLCHAIN_EXTERNAL=y
BR2_TOOLCHAIN_EXTERNAL_LINARO_ARM201204=y
BR2_PACKAGE_BUSYBOX_SHOW_OTHERS=y
BR2_PACKAGE_HOST_GDB=y
BR2_PACKAGE_AML_CUSTOMER=y
BR2_PACKAGE_AML_CUSTOMER_VERSION="master"
BR2_PACKAGE_AML_CUSTOMER_GIT_URL="git://git.myamlogic.com/kernel/customer.git"
BR2_PACKAGE_ALSA_UTILS=y
#
# ALSA utils selection
#
BR2_PACKAGE_ALSA_UTILS_ALSACTL=y
BR2_PACKAGE_ALSA_UTILS_ALSACONF=y
BR2_PACKAGE_ALSA_UTILS_AMIXER=y
BR2_PACKAGE_ALSA_UTILS_ALSAMIXER=y
BR2_PACKAGE_ALSA_UTILS_APLAY=y
BR2_PACKAGE_GSTREAMER=y
BR2_PACKAGE_GSTREAMER_GST_DEBUG=y
BR2_PACKAGE_GSTREAMER_PLUGIN_REGISTRY=y
BR2_PACKAGE_GST_PLUGINS_BASE=y

#
# dependency-less plugins
#
BR2_PACKAGE_GST_PLUGINS_BASE_PLUGIN_AUDIOCONVERT=y
BR2_PACKAGE_GST_PLUGINS_BASE_PLUGIN_AUDIORESAMPLE=y
BR2_PACKAGE_GST_PLUGINS_BASE_PLUGIN_FFMPEGCOLORSPACE=y
BR2_PACKAGE_GST_PLUGINS_BASE_PLUGIN_PLAYBACK=y
BR2_PACKAGE_GST_PLUGINS_BASE_PLUGIN_TYPEFIND=y
BR2_PACKAGE_GST_PLUGINS_BASE_PLUGIN_VIDEOSCALE=y
BR2_PACKAGE_GST_PLUGINS_BASE_PLUGIN_VOLUME=y
BR2_PACKAGE_GST_PLUGINS_GOOD_PLUGIN_AUDIOPARSERS=y
BR2_PACKAGE_GST_PLUGINS_GOOD_PLUGIN_AVI=y
BR2_PACKAGE_GST_PLUGINS_GOOD_PLUGIN_ID3DEMUX=y
BR2_PACKAGE_GST_PLUGINS_GOOD_PLUGIN_ISOMP4=y
BR2_PACKAGE_GST_PLUGINS_GOOD_PLUGIN_MATROSKA=y
BR2_PACKAGE_GST_PLUGINS_GOOD_PLUGIN_WAVPARSE=y
BR2_PACKAGE_GST_PLUGINS_GOOD_PLUGIN_AUTODETECT=y

#
# plugins with external dependencies (there may be more available)
#
BR2_PACKAGE_GST_PLUGINS_BASE_PLUGIN_ALSA=y
BR2_PACKAGE_GST_PLUGINS_GOOD=y
BR2_PACKAGE_GST_APP=y
BR2_PACKAGE_GST_AML_PLUGINS=y
BR2_PACKAGE_AML_LIBS=y

#
# plugins with external dependencies
#
BR2_PACKAGE_GST_PLUGINS_GOOD_PLUGIN_SOUPHTTPSRC=y

#
# souphttpsrc requires a toolchain with WCHAR and threading support
#
BR2_PACKAGE_GST_PLUGINS_GOOD_PLUGIN_WAVPACK=y
BR2_PACKAGE_GST_PLUGINS_BAD=y

#
# dependency-less plugins
#
BR2_PACKAGE_GST_PLUGINS_BAD_PLUGIN_H264PARSE=y
BR2_PACKAGE_GST_PLUGINS_BAD_PLUGIN_ID3TAG=y
BR2_PACKAGE_GST_PLUGINS_BAD_PLUGIN_MPEGDEMUX=y
BR2_PACKAGE_GST_PLUGINS_BAD_PLUGIN_MPEGTSDEMUX=y

#
# plugins with external dependencies (there may be more available)
#
BR2_PACKAGE_GST_PLUGINS_BAD_PLUGIN_DIRECTFB=y
BR2_PACKAGE_GST_PLUGINS_UGLY=y

#
# dependency-less plugins
#
BR2_PACKAGE_GST_PLUGINS_UGLY_PLUGIN_ASFDEMUX=y
BR2_PACKAGE_GST_PLUGINS_UGLY_PLUGIN_MPEGAUDIOPARSE=y

#
# plugins with external dependencies (there may be more available)
#
BR2_PACKAGE_GST_PLUGINS_UGLY_PLUGIN_MAD=y
BR2_PACKAGE_GST_FLUENDO_MPEGDEMUX=y
BR2_PACKAGE_WAVPACK=y

#
# Audio/Sound
#
BR2_PACKAGE_ALSA_LIB=y

#
# ALSA lib selection
#
BR2_PACKAGE_ALSA_LIB_DEVDIR="/dev/snd"
BR2_PACKAGE_ALSA_LIB_PCM_PLUGINS="all"
BR2_PACKAGE_ALSA_LIB_CTL_PLUGINS="all"
BR2_PACKAGE_ALSA_LIB_ALOAD=y
BR2_PACKAGE_ALSA_LIB_MIXER=y
BR2_PACKAGE_ALSA_LIB_PCM=y
BR2_PACKAGE_ALSA_LIB_RAWMIDI=y
BR2_PACKAGE_ALSA_LIB_HWDEP=y
BR2_PACKAGE_ALSA_LIB_SEQ=y
BR2_PACKAGE_ALSA_LIB_ALISP=y
BR2_PACKAGE_ALSA_LIB_OLD_SYMBOLS=y
BR2_PACKAGE_LIBID3TAG=y
BR2_PACKAGE_LIBMAD=y
BR2_PACKAGE_LIBMAD_OPTIMIZATION_DEFAULT=y
BR2_PACKAGE_LIBMAD_ASO=y
BR2_PACKAGE_LIBPLAYER=y
BR2_PACKAGE_GDB=y
BR2_PACKAGE_GDB_SERVER=y
BR2_PACKAGE_GDB_DEBUGGER=y
BR2_PACKAGE_DIRECTFB=y
BR2_PACKAGE_E2FSPROGS=y
BR2_PACKAGE_FBDUMP=y
BR2_PACKAGE_FBGRAB=y
BR2_PACKAGE_FBSET=y
BR2_PACKAGE_FBTERM=y
BR2_PACKAGE_FB_TEST_APP=y
BR2_PACKAGE_UTIL_LINUX_BINARIES=y
BR2_PACKAGE_QT=y
BR2_PACKAGE_QT_DEBUG=y
BR2_PACKAGE_QT_DEMOS=y
BR2_PACKAGE_QT_LICENSE_APPROVED=y
BR2_PACKAGE_QT_GIF=y
BR2_PACKAGE_QT_QTJPEG=y
BR2_PACKAGE_QT_QTPNG=y
BR2_PACKAGE_QT_QTTIFF=y
BR2_PACKAGE_QT_GFX_EGLNULLWS=y
BR2_PACKAGE_QT_MOUSE_LINUXINPUT=y
BR2_PACKAGE_QT_MOUSE_TSLIB=y
BR2_PACKAGE_QT_MOUSE_NO_QWS_CURSOR=y
BR2_PACKAGE_QT_KEYBOARD_TTY=y
BR2_PACKAGE_QT_KEYBOARD_LINUXINPUT=y
BR2_PACKAGE_QT_OPENGL_ES=y
BR2_PACKAGE_OPENSSL=y
BR2_PACKAGE_SQLITE=y
BR2_PACKAGE_CAIRO_SCRIPT=y
BR2_PACKAGE_LIBJPEG=y
BR2_PACKAGE_JPEG=y
BR2_PACKAGE_OPENGL=y
BR2_PACKAGE_TSLIB=y
BR2_PACKAGE_NCURSES=y
BR2_PACKAGE_NCURSES_TARGET_PANEL=y
BR2_PACKAGE_NCURSES_TARGET_FORM=y
BR2_PACKAGE_NCURSES_TARGET_MENU=y
BR2_PACKAGE_KMOD=y
BR2_PACKAGE_PANGO=y
BR2_PACKAGE_REMOTECFG=y
BR2_PACKAGE_LIBCARES=y
BR2_PACKAGE_LIBCURL=y
BR2_PACKAGE_BOOST=y
BR2_PACKAGE_LIBEVENT=y
BR2_PACKAGE_ICU=y
BR2_PACKAGE_CJSON=y
BR2_PACKAGE_LIBXSLT=y
BR2_PACKAGE_DHCPCD=y
BR2_PACKAGE_DNSMASQ=y
BR2_PACKAGE_DNSMASQ_TFTP=n
BR2_PACKAGE_DNSMASQ_DHCP=n
BR2_PACKAGE_IW=y
BR2_PACKAGE_WPA_SUPPLICANT=y
BR2_PACKAGE_WPA_SUPPLICANT_CLI=y
BR2_PACKAGE_LIBNL=y
BR2_PACKAGE_VIM=y
BR2_TARGET_ROOTFS_CPIO=y
BR2_TARGET_ROOTFS_CPIO_GZIP=y 
BR2_TARGET_ROOTFS_CPIO_UIMAGE=y
BR2_TARGET_ROOTFS_INITRAMFS=y
BR2_TARGET_ROOTFS_INITRAMFS_LIST="board/amlogic/meson_g18/initramfs/ramfslist-wo-nand-3.0"
BR2_TARGET_ROOTFS_EXT2=y
BR2_TARGET_ROOTFS_EXT2_4=y
BR2_TARGET_ROOTFS_EXT2_BLOCKS=1048576
BR2_TARGET_ROOTFS_TAR_GZIP=y
BR2_ROOTFS_DEVICE_CREATION_DYNAMIC_MDEV=y
BR2_ROOTFS_OVERLAY="board/amlogic/meson_g18/rootfs/"
BR2_LINUX_KERNEL=y                                                                                         
BR2_LINUX_KERNEL_CUSTOM_GIT=y                                               
BR2_LINUX_KERNEL_CUSTOM_REPO_URL="git://git.myamlogic.com/kernel/common.git"
BR2_LINUX_KERNEL_CUSTOM_REPO_VERSION="amlogic-3.0"                           
BR2_LINUX_KERNEL_DEFCONFIG="meson6_g18_buildroot"
BR2_TARGET_BOARD_PLATFORM="meson6"
BR2_LINUX_KERNEL_PATCH="linux/amlogic-3.0"
BR2_PACKAGE_GPU=y
BR2_PACKAGE_GPU_VERSION="r3p2-EAC"
BR2_PACKAGE_GPU_GIT_URL="git://git.myamlogic.com/platform/hardware/arm/gpu.git"
BR2_PACKAGE_OPENGL_MALI_VERSION="m400"
BR2_PACKAGE_WIFI_FW=y
BR2_PACKAGE_WIFI_CUSTOM_GIT_VERSION="jb-mr1-amlogic"
BR2_PACKAGE_WIFI_FW_CUSTOM_GIT_REPO_URL="git://git.myamlogic.com/platform/hardware/amlogic/wifi.git"
BR2_PACKAGE_MALI_EXAMPLES=y
BR2_PACKAGE_AML_NAND=n
BR2_PACKAGE_AML_NAND_VERSION="amlogic-nand"
BR2_PACKAGE_AML_NAND_GIT_URL="git://git.myamlogic.com/platform/hardware/amlogic/nand.git"
BR2_TARGET_UBOOT=y
BR2_TARGET_UBOOT_CUSTOM_GIT=y
BR2_TARGET_UBOOT_CUSTOM_REPO_URL="git://git.myamlogic.com/uboot.git"
BR2_TARGET_UBOOT_CUSTOM_REPO_VERSION="next"
BR2_TARGET_UBOOT_BOARDNAME="m6_mbx_v1"
BR2_PACKAGE_AML_UBOOT_CUSTOMER=y
BR2_PACKAGE_AML_UBOOT_CUSTOMER_GIT_REPO_URL="git://git.myamlogic.com/uboot/customer.git"
BR2_PACKAGE_AML_UBOOT_CUSTOMER_GIT_VERSION="next"
BR2_TARGET_UBOOT_AMLOGIC=y
```
