## buildroot/configs/meson8_3.10_vlsi_defconfig
```kconfig
# Mirrors and Download locations
BR2_BACKUP_SITE="http://openlinux.amlogic.com:8000/download/GPL_code_release/ThirdParty"
# Architecture
BR2_arm=y
BR2_cortex_a9=y
BR2_ARM_ENABLE_NEON=y
BR2_ARM_FPU_NEON=y
BR2_DEPRECATED=y
BR2_TOOLCHAIN_EXTERNAL=y
#BR2_TOOLCHAIN_EXTERNAL_LINARO_ARM201204=y
BR2_TOOLCHAIN_EXTERNAL_LINARO_ARM_201405=y
BR2_PACKAGE_BUSYBOX_SHOW_OTHERS=y
BR2_ARM_EABIHF=y 
BR2_ARM_ENABLE_VFP=y
BR2_PACKAGE_AML_CUSTOMER=y
BR2_PACKAGE_AML_CUSTOMER_VERSION="master"
BR2_PACKAGE_AML_CUSTOMER_GIT_URL="git://git.myamlogic.com/kernel/customer.git"
BR2_PACKAGE_DIRECTFB=y
BR2_PACKAGE_E2FSPROGS=y
BR2_PACKAGE_FBDUMP=y
BR2_PACKAGE_FBGRAB=y
BR2_PACKAGE_FBSET=y
BR2_PACKAGE_FBTERM=y
BR2_PACKAGE_OPENGL=y
BR2_PACKAGE_IW=y
BR2_PACKAGE_WPA_SUPPLICANT=y
BR2_PACKAGE_WPA_SUPPLICANT_CLI=y
BR2_PACKAGE_LIBNL=y
BR2_PACKAGE_VIM=y
BR2_TARGET_ROOTFS_CPIO=y
BR2_TARGET_ROOTFS_CPIO_GZIP=y 
BR2_TARGET_ROOTFS_CPIO_UIMAGE=y
BR2_TARGET_ROOTFS_INITRAMFS_LIST="board/amlogic/meson_skt/initramfs/ramfslist-hf"
BR2_TARGET_ROOTFS_EXT2=y
BR2_TARGET_ROOTFS_EXT2_4=y
BR2_TARGET_ROOTFS_EXT2_BLOCKS=1048576
BR2_TARGET_ROOTFS_TAR_GZIP=y
BR2_ROOTFS_DEVICE_CREATION_DYNAMIC_MDEV=y
BR2_LINUX_KERNEL=y                                                                                         
BR2_LINUX_KERNEL_CUSTOM_GIT=y                                               
BR2_LINUX_KERNEL_CUSTOM_REPO_URL="git://git.myamlogic.com/kernel/common.git"
BR2_LINUX_KERNEL_CUSTOM_REPO_VERSION="amlogic-3.10-bringup"                           
BR2_LINUX_KERNEL_DEFCONFIG="meson8_vlsi"
BR2_TARGET_BOARD_PLATFORM="meson8"
BR2_LINUX_KERNEL_PATCH="linux/amlogic-3.10"
BR2_LINUX_KERNEL_DTS_SUPPORT=y
BR2_LINUX_KERNEL_USE_INTREE_DTS=y
BR2_LINUX_KERNEL_INTREE_DTS_NAME="meson8_skt"
BR2_LINUX_KERNEL_AMLOGIC_DTD=y
BR2_LINUX_KERNEL_AMLOGIC_DTD_STRIP=y
BR2_LINUX_KERNEL_ANDROID_FORMAT=y
BR2_PACKAGE_GPU=y
BR2_PACKAGE_GPU_VERSION="r5p1"
BR2_PACKAGE_GPU_GIT_URL="git://git.myamlogic.com/platform/hardware/arm/gpu.git"
BR2_PACKAGE_OPENGL_MALI_VERSION="m450"
BR2_PACKAGE_WIFI_FW=y
BR2_PACKAGE_WIFI_CUSTOM_GIT_VERSION="kk-amlogic"
BR2_PACKAGE_WIFI_FW_CUSTOM_GIT_REPO_URL="git://git.myamlogic.com/platform/hardware/amlogic/wifi.git"
BR2_PACKAGE_RTK8188EU=y
BR2_PACKAGE_RTK8188EU_GIT_VERSION="8188eu"
BR2_PACKAGE_RTK8188EU_GIT_REPO_URL="git://git.myamlogic.com/platform/hardware/wifi/realtek/drivers/8188eu.git"
BR2_PACKAGE_RTK8192CU=y
BR2_PACKAGE_RTK8192CU_GIT_VERSION="8192cu"
BR2_PACKAGE_RTK8192CU_GIT_REPO_URL="git://git.myamlogic.com/platform/hardware/wifi/realtek/drivers/8192cu.git"
BR2_PACKAGE_RTK8192DU=y
BR2_PACKAGE_RTK8192DU_GIT_VERSION="8192du"
BR2_PACKAGE_RTK8192DU_GIT_REPO_URL="git://git.myamlogic.com/platform/hardware/wifi/realtek/drivers/8192du.git"
BR2_PACKAGE_RTK8192EU=y
BR2_PACKAGE_RTK8192EU_GIT_VERSION="8192eu"
BR2_PACKAGE_RTK8192EU_GIT_REPO_URL="git://git.myamlogic.com/platform/hardware/wifi/realtek/drivers/8192eu.git"
BR2_PACKAGE_RTK8189ES=y
BR2_PACKAGE_RTK8189ES_GIT_VERSION="8189es"
BR2_PACKAGE_RTK8189ES_GIT_REPO_URL="git://git.myamlogic.com/platform/hardware/wifi/realtek/drivers/8189es.git"
BR2_PACKAGE_RTK8723BS=y
BR2_PACKAGE_RTK8723BS_GIT_VERSION="8723bs"
BR2_PACKAGE_RTK8723BS_GIT_REPO_URL="git://git.myamlogic.com/platform/hardware/wifi/realtek/drivers/8723bs.git"
BR2_PACKAGE_RTK8723AU=y
BR2_PACKAGE_RTK8723AU_GIT_VERSION="8723au"
BR2_PACKAGE_RTK8723AU_GIT_REPO_URL="git://git.myamlogic.com/platform/hardware/wifi/realtek/drivers/8723au.git"
BR2_PACKAGE_RTK8723BU=y
BR2_PACKAGE_RTK8723BU_GIT_VERSION="8723bu"
BR2_PACKAGE_RTK8723BU_GIT_REPO_URL="git://git.myamlogic.com/platform/hardware/wifi/realtek/drivers/8723bu.git"
BR2_PACKAGE_RTK8811AU=y
BR2_PACKAGE_RTK8811AU_GIT_VERSION="8811au"
BR2_PACKAGE_RTK8811AU_GIT_REPO_URL="git://git.myamlogic.com/platform/hardware/wifi/realtek/drivers/8811au.git"
BR2_PACKAGE_RTK8812AU=y
BR2_PACKAGE_RTK8812AU_GIT_VERSION="8812au"
BR2_PACKAGE_RTK8812AU_GIT_REPO_URL="git://git.myamlogic.com/platform/hardware/wifi/realtek/drivers/8812au.git"
BR2_PACKAGE_BRCMAP6XXX=y
BR2_PACKAGE_BRCMAP6XXX_GIT_VERSION="ap6xxx"
BR2_PACKAGE_BRCMAP6XXX_GIT_REPO_URL="git://git.myamlogic.com/platform/hardware/wifi/broadcom/drivers/ap6xxx.git"
BR2_PACKAGE_AML_TVIN=y
BR2_PACKAGE_AML_TVIN_GIT_VERSION="amlogic-3.10-bringup"
BR2_PACKAGE_AML_TVIN_GIT_REPO_URL="git://git.myamlogic.com/linux/amlogic/tvin.git"
BR2_PACKAGE_AML_PMU=y
BR2_PACKAGE_AML_PMU_GIT_VERSION="master"
BR2_PACKAGE_AML_PMU_GIT_REPO_URL="git://git.myamlogic.com/platform/hardware/amlogic/pmu.git"
BR2_PACKAGE_AML_TOUCH=y
BR2_PACKAGE_AML_TOUCH_GIT_VERSION="kk-amlogic"
BR2_PACKAGE_AML_TOUCH_GIT_REPO_URL="git://git.myamlogic.com/platform/hardware/amlogic/touch.git"
BR2_PACKAGE_AML_NAND=y
BR2_PACKAGE_AML_NAND_VERSION="amlogic-nand"
BR2_PACKAGE_AML_NAND_GIT_URL="git://git.myamlogic.com/platform/hardware/amlogic/nand.git"
BR2_PACKAGE_AML_UTIL=y
BR2_TARGET_UBOOT=y
BR2_TARGET_UBOOT_CUSTOM_GIT=y
BR2_TARGET_UBOOT_CUSTOM_REPO_URL="git://git.myamlogic.com/uboot.git"
BR2_TARGET_UBOOT_CUSTOM_REPO_VERSION="next"
BR2_TARGET_UBOOT_BOARDNAME="m8_skt_v1"
BR2_PACKAGE_AML_UBOOT_CUSTOMER=y
BR2_PACKAGE_AML_UBOOT_CUSTOMER_GIT_REPO_URL="git://git.myamlogic.com/uboot/customer.git"
BR2_PACKAGE_AML_UBOOT_CUSTOMER_GIT_VERSION="next"
BR2_TARGET_UBOOT_AMLOGIC=y
```
