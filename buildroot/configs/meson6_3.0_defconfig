## buildroot/configs/mesongxb_p200_x_defconfig
```kconfig
# Mirrors and Download locations
BR2_BACKUP_SITE="http://openlinux.amlogic.com:8000/download/GPL_code_release/ThirdParty"
# Architecture
BR2_aarch64=y
BR2_ARM_ENABLE_NEON=y
BR2_ARM_FPU_NEON=y
BR2_TOOLCHAIN_EXTERNAL_LINARO_AARCH64_201409=y
BR2_DEPRECATED=y
BR2_TOOLCHAIN_EXTERNAL=y
#BR2_ENABLE_DEBUG=y
BR2_PACKAGE_BUSYBOX_SHOW_OTHERS=y
BR2_PACKAGE_HOST_GDB=y
BR2_PACKAGE_ALSA_UTILS=y
#
# ALSA utils selection
#
BR2_PACKAGE_ALSA_UTILS_ALSACTL=y
BR2_PACKAGE_ALSA_UTILS_ALSACONF=y
BR2_PACKAGE_ALSA_UTILS_AMIXER=y
BR2_PACKAGE_ALSA_UTILS_ALSAMIXER=y
BR2_PACKAGE_ALSA_UTILS_APLAY=y
BR2_PACKAGE_AMAUDIO=y
BR2_PACKAGE_AML_LIBS=y
#
# Gstreamer 1
#
BR2_PACKAGE_GSTREAMER1=y
BR2_PACKAGE_GSTREAMER1_PARSE=y
BR2_PACKAGE_GSTREAMER1_TRACE=y
BR2_PACKAGE_GSTREAMER1_GST_DEBUG=y
BR2_PACKAGE_GSTREAMER1_PLUGIN_REGISTRY=y
BR2_PACKAGE_GSTREAMER1_INSTALL_TOOLS=y
BR2_PACKAGE_GST1_PLUGINS_BASE=y

#
# dependency-less plugins
#
BR2_PACKAGE_GST1_PLUGINS_BASE_PLUGIN_AUDIOCONVERT=y
BR2_PACKAGE_GST1_PLUGINS_BASE_PLUGIN_VIDEOCONVERT=y
BR2_PACKAGE_GST1_PLUGINS_BASE_PLUGIN_PLAYBACK=y
BR2_PACKAGE_GST1_PLUGINS_BASE_PLUGIN_AUDIORESAMPLE=y
BR2_PACKAGE_GST1_PLUGINS_BASE_PLUGIN_SUBPARSE=y
BR2_PACKAGE_GST1_PLUGINS_BASE_PLUGIN_TYPEFIND=y
BR2_PACKAGE_GST1_PLUGINS_BASE_PLUGIN_VIDEOSCALE=y
BR2_PACKAGE_GST1_PLUGINS_BASE_PLUGIN_VOLUME=y

#
# plugins with external dependencies
#
BR2_PACKAGE_GST1_PLUGINS_BASE_PLUGIN_OGG=y
BR2_PACKAGE_GST1_PLUGINS_GOOD=y
BR2_PACKAGE_GST1_PLUGINS_GOOD_ZLIB=y

#
# dependency-less plugins
#
BR2_PACKAGE_GST1_PLUGINS_GOOD_PLUGIN_ALPHA=y
BR2_PACKAGE_GST1_PLUGINS_GOOD_PLUGIN_APETAG=y
BR2_PACKAGE_GST1_PLUGINS_GOOD_PLUGIN_AUDIOPARSERS=y
BR2_PACKAGE_GST1_PLUGINS_GOOD_PLUGIN_AUPARSE=y
BR2_PACKAGE_GST1_PLUGINS_GOOD_PLUGIN_AUTODETECT=y
BR2_PACKAGE_GST1_PLUGINS_GOOD_PLUGIN_AVI=y
BR2_PACKAGE_GST1_PLUGINS_GOOD_PLUGIN_DEINTERLACE=y
BR2_PACKAGE_GST1_PLUGINS_GOOD_PLUGIN_FLV=y
BR2_PACKAGE_GST1_PLUGINS_GOOD_PLUGIN_ICYDEMUX=y
BR2_PACKAGE_GST1_PLUGINS_GOOD_PLUGIN_ID3DEMUX=y
BR2_PACKAGE_GST1_PLUGINS_GOOD_PLUGIN_ISOMP4=y
BR2_PACKAGE_GST1_PLUGINS_GOOD_PLUGIN_MATROSKA=y
BR2_PACKAGE_GST1_PLUGINS_GOOD_PLUGIN_RTP=y
BR2_PACKAGE_GST1_PLUGINS_GOOD_PLUGIN_RTPMANAGER=y
BR2_PACKAGE_GST1_PLUGINS_GOOD_PLUGIN_RTSP=y
BR2_PACKAGE_GST1_PLUGINS_GOOD_PLUGIN_UDP=y
BR2_PACKAGE_GST1_PLUGINS_GOOD_PLUGIN_VIDEOFILTER=y

#
# plugins with external dependencies
#
BR2_PACKAGE_GST1_PLUGINS_GOOD_PLUGIN_SOUPHTTPSRC=y
BR2_PACKAGE_GST1_PLUGINS_GOOD_PLUGIN_TAGLIB=y
BR2_PACKAGE_GST1_PLUGINS_BAD=y

#
# dependency-less plugins
#
BR2_PACKAGE_GST1_PLUGINS_BAD_PLUGIN_AIFF=y
BR2_PACKAGE_GST1_PLUGINS_BAD_PLUGIN_AUTOCONVERT=y
BR2_PACKAGE_GST1_PLUGINS_BAD_PLUGIN_CDXAPARSE=y
BR2_PACKAGE_GST1_PLUGINS_BAD_PLUGIN_HDVPARSE=y
BR2_PACKAGE_GST1_PLUGINS_BAD_PLUGIN_ID3TAG=y
BR2_PACKAGE_GST1_PLUGINS_BAD_PLUGIN_INTERLACE=y
BR2_PACKAGE_GST1_PLUGINS_BAD_PLUGIN_IVFPARSE=y
BR2_PACKAGE_GST1_PLUGINS_BAD_PLUGIN_MPEGDEMUX=y
BR2_PACKAGE_GST1_PLUGINS_BAD_PLUGIN_MPEGTSDEMUX=y
BR2_PACKAGE_GST1_PLUGINS_BAD_PLUGIN_NUVDEMUX=y
BR2_PACKAGE_GST1_PLUGINS_BAD_PLUGIN_PATCHDETECT=y
BR2_PACKAGE_GST1_PLUGINS_BAD_PLUGIN_PCAPPARSE=y
BR2_PACKAGE_GST1_PLUGINS_BAD_PLUGIN_RAWPARSE=y
BR2_PACKAGE_GST1_PLUGINS_BAD_PLUGIN_SMOOTH=y
BR2_PACKAGE_GST1_PLUGINS_BAD_PLUGIN_VIDEOFILTERS=y
BR2_PACKAGE_GST1_PLUGINS_BAD_PLUGIN_VIDEOPARSERS=y

#
# plugins with external dependencies
#
BR2_PACKAGE_GST1_PLUGINS_BAD_PLUGIN_BZ2=y
BR2_PACKAGE_GST1_PLUGINS_BAD_PLUGIN_CURL=y
BR2_PACKAGE_GST1_PLUGINS_BAD_PLUGIN_DASH=y
BR2_PACKAGE_GST1_PLUGINS_BAD_PLUGIN_DIRECTFB=y
#
# gl needs the gst1-plugins-bad opengl library
#
BR2_PACKAGE_GST1_PLUGINS_BAD_PLUGIN_HLS=y
BR2_PACKAGE_GST1_PLUGINS_UGLY=y

#
# dependency-less plugins
#
BR2_PACKAGE_GST1_PLUGINS_UGLY_PLUGIN_ASFDEMUX=y
BR2_PACKAGE_GST1_PLUGINS_UGLY_PLUGIN_REALMEDIA=y

#
# plugins with external dependencies (there may be more available)
#
BR2_PACKAGE_GST1_VALIDATE=y

#
# gst-omx requires a OpenMAX implementation
#
BR2_PACKAGE_KODI_ARCH_SUPPORTS=y
BR2_PACKAGE_KODI_EGL_GLES=y
BR2_PACKAGE_GST_AML_PLUGINS1=y
BR2_PACKAGE_MPLAYER_ARCH_SUPPORTS=y
BR2_PACKAGE_WAVPACK=y

#
# Audio/Sound
#
BR2_PACKAGE_ALSA_LIB=y
BR2_PACKAGE_LIBSAMPLERATE=y

#
# ALSA lib selection
#
BR2_PACKAGE_ALSA_LIB_DEVDIR="/dev/snd"
BR2_PACKAGE_ALSA_LIB_PCM_PLUGINS="all"
BR2_PACKAGE_ALSA_LIB_CTL_PLUGINS="all"
BR2_PACKAGE_ALSA_LIB_ALOAD=y
BR2_PACKAGE_ALSA_LIB_MIXER=y
BR2_PACKAGE_ALSA_LIB_PCM=y
BR2_PACKAGE_ALSA_LIB_RAWMIDI=y
BR2_PACKAGE_ALSA_LIB_HWDEP=y
BR2_PACKAGE_ALSA_LIB_SEQ=y
BR2_PACKAGE_ALSA_LIB_ALISP=y
BR2_PACKAGE_ALSA_LIB_OLD_SYMBOLS=y
BR2_PACKAGE_LIBID3TAG=y
BR2_PACKAGE_LIBMAD=y
BR2_PACKAGE_LIBMAD_OPTIMIZATION_DEFAULT=y
BR2_PACKAGE_LIBMAD_ASO=y
BR2_PACKAGE_LIBPLAYER=y
BR2_PACKAGE_MPLAYER=y
BR2_PACKAGE_GDB=y
BR2_PACKAGE_GDB_SERVER=y
BR2_PACKAGE_GDB_DEBUGGER=y
BR2_PACKAGE_DIRECTFB=y
BR2_PACKAGE_E2FSPROGS=y
BR2_PACKAGE_FBDUMP=y
BR2_PACKAGE_FBSET=y
BR2_PACKAGE_FB_TEST_APP=y
BR2_PACKAGE_UTIL_LINUX_BINARIES=y
BR2_PACKAGE_LIBDRM=y
BR2_PACKAGE_LIBDRI2=y
BR2_PACKAGE_XORG7=y
BR2_PACKAGE_XSERVER_XORG_SERVER=y
BR2_PACKAGE_XSERVER_XORG_SERVER_MODULAR=y
BR2_PACKAGE_XLIB_LIBXCOMPOSITE=y
BR2_PACKAGE_XAPP_XCLOCK=y
BR2_PACKAGE_XAPP_XEDIT=y
BR2_PACKAGE_XAPP_XLOGO=y
BR2_PACKAGE_XDRIVER_XF86_INPUT_EVDEV=y
BR2_PACKAGE_XDRIVER_XF86_INPUT_KEYBOARD=y
BR2_PACKAGE_XDRIVER_XF86_INPUT_MOUSE=y
BR2_PACKAGE_XDRIVER_XF86_VIDEO_FBDEV=y
BR2_PACKAGE_XDRIVER_XF86_VIDEO_FBTURBO=y
BR2_PACKAGE_XDRIVER_XF86_VIDEO_MALI=y
BR2_PACKAGE_XPROTO_XF86DRIPROTO=y
BR2_PACKAGE_XPROTO_DRI2PROTO=y
BR2_PACKAGE_LUA=y
BR2_PACKAGE_LUA_5_1=y
BR2_PACKAGE_EFL=y
BR2_PACKAGE_ENLIGHTENMENT=y
BR2_PACKAGE_XTERM=y
BR2_PACKAGE_XAPP_XDPYINFO=y
BR2_PACKAGE_EUDEV_RULES_GEN=y
BR2_PACKAGE_LIBGTK2=y
#BR2_PACKAGE_MESA3D=y
BR2_PACKAGE_GLMARK2=y
# other GUIs
BR2_PACKAGE_QT5=y
BR2_PACKAGE_QT5BASE=y
BR2_PACKAGE_QT5BASE_LICENSE_APPROVED=y
BR2_PACKAGE_QT5BASE_NETWORK=y
BR2_PACKAGE_QT5BASE_CONCURRENT=y
BR2_PACKAGE_QT5BASE_SQL=y
BR2_PACKAGE_QT5BASE_SQLITE_SYSTEM=y
BR2_PACKAGE_QT5BASE_TEST=y
BR2_PACKAGE_QT5BASE_XML=y
BR2_PACKAGE_QT5BASE_GUI=y
BR2_PACKAGE_QT5BASE_WIDGETS=y
BR2_PACKAGE_QT5BASE_LINUXFB=y
BR2_PACKAGE_QT5BASE_DIRECTFB=y

#
# X.org XCB backend available if X.org is enabled
#
BR2_PACKAGE_QT5BASE_EGLFS=y
BR2_PACKAGE_QT5BASE_XCB=y
BR2_PACKAGE_QT5BASE_PRINTSUPPORT=y
BR2_PACKAGE_QT5BASE_FONTCONFIG=y
BR2_PACKAGE_QT5BASE_GIF=y
BR2_PACKAGE_QT5BASE_JPEG=y
BR2_PACKAGE_QT5BASE_PNG=y
BR2_PACKAGE_QT5BASE_DBUS=y
BR2_PACKAGE_QT5BASE_ICU=y
BR2_PACKAGE_QT5BASE_TSLIB=y
BR2_PACKAGE_QT5DECLARATIVE=y
BR2_PACKAGE_QT5GRAPHICALEFFECTS=y
BR2_PACKAGE_QT5IMAGEFORMATS=y
BR2_PACKAGE_QT5MULTIMEDIA=y
BR2_PACKAGE_QT5QUICK1=y
BR2_PACKAGE_QT5QUICKCONTROLS=y
BR2_PACKAGE_QT5SCRIPT=y
BR2_PACKAGE_QT5SENSORS=y
BR2_PACKAGE_QT5SERIALPORT=y
BR2_PACKAGE_QT5SVG=y
BR2_PACKAGE_QT5WEBKIT=y
BR2_PACKAGE_QT5XMLPATTERNS=y
BR2_PACKAGE_QT5BASE_EXAMPLES=y
BR2_PACKAGE_QT5X11EXTRAS=y
BR2_PACKAGE_OPENSSL=y
BR2_PACKAGE_OPENSSL_BIN=y
BR2_PACKAGE_OPENSSL_ENGINES=y
BR2_PACKAGE_SQLITE=y
BR2_PACKAGE_CAIRO_SCRIPT=y
BR2_PACKAGE_LIBJPEG=y
BR2_PACKAGE_JPEG=y
BR2_PACKAGE_OPENGL=y
BR2_PACKAGE_TSLIB=y
BR2_PACKAGE_NCURSES=y
BR2_PACKAGE_NCURSES_TARGET_PANEL=y
BR2_PACKAGE_NCURSES_TARGET_FORM=y
BR2_PACKAGE_NCURSES_TARGET_MENU=y
BR2_PACKAGE_KMOD=y
BR2_PACKAGE_PANGO=y
BR2_PACKAGE_REMOTECFG=y
BR2_PACKAGE_LIBCARES=y
BR2_PACKAGE_LIBCURL=y
BR2_PACKAGE_BOOST=y
BR2_PACKAGE_ICU=y
BR2_PACKAGE_CJSON=y
BR2_PACKAGE_LIBXSLT=y
BR2_PACKAGE_DHCPCD=y
BR2_PACKAGE_IW=y
BR2_PACKAGE_LIBSOUP_SSL=y
BR2_PACKAGE_NTP=y
BR2_PACKAGE_NTP_NTPDATE=y
BR2_PACKAGE_WPA_SUPPLICANT=y
BR2_PACKAGE_WPA_SUPPLICANT_CLI=y
BR2_PACKAGE_LIBNL=y
BR2_PACKAGE_VIM=y
BR2_TARGET_ROOTFS_CPIO=y
BR2_TARGET_ROOTFS_CPIO_GZIP=y
BR2_TARGET_ROOTFS_CPIO_UIMAGE=y
BR2_TARGET_ROOTFS_INITRAMFS_LIST="board/amlogic/mesongxb_p200_x/initramfs/ramfslist"
BR2_TARGET_ROOTFS_EXT2=y
BR2_TARGET_ROOTFS_EXT2_4=y
BR2_TARGET_ROOTFS_EXT2_BLOCKS=1048576
BR2_TARGET_ROOTFS_TAR_GZIP=y
BR2_ROOTFS_DEVICE_CREATION_DYNAMIC_EUDEV=y
BR2_ROOTFS_OVERLAY="board/amlogic/mesongxb_p200_x/rootfs/"
BR2_LINUX_KERNEL=y
BR2_LINUX_KERNEL_CUSTOM_GIT=y
BR2_LINUX_KERNEL_CUSTOM_REPO_URL="git://git.myamlogic.com/kernel/common.git"
BR2_LINUX_KERNEL_CUSTOM_REPO_VERSION="amlogic-3.14-dev"
BR2_LINUX_KERNEL_DEFCONFIG="meson64"
BR2_TARGET_BOARD_PLATFORM="meson8"
BR2_LINUX_KERNEL_IMAGE_LOADADDR="0x1008000"
BR2_LINUX_KERNEL_PATCH="linux/amlogic-3.14"
BR2_LINUX_KERNEL_DTS_SUPPORT=y
BR2_LINUX_KERNEL_USE_INTREE_DTS=y
BR2_LINUX_KERNEL_INTREE_DTS_NAME="gxbb_p200"
BR2_LINUX_KERNEL_AMLOGIC_DTD=y
BR2_LINUX_KERNEL_ANDROID_FORMAT=y
BR2_LINUX_KERNEL_IMAGE=y
BR2_PACKAGE_GPU=y
BR2_PACKAGE_GPU_STANDALONE=y
BR2_PACKAGE_GPU_UMP=n
BR2_PACKAGE_GPU_MALI_DRM=y
BR2_PACKAGE_GPU_MALI_DMA_SHARED_BUFFER=y
BR2_PACKAGE_GPU_VERSION="r6p1"
BR2_PACKAGE_GPU_GIT_URL="git://git.myamlogic.com/platform/hardware/arm/gpu.git"
BR2_PACKAGE_OPENGL_VERSION="r6p1"
BR2_PACKAGE_OPENGL_MALI_VERSION="m450-X"
BR2_PACKAGE_WIFI_FW=y
BR2_PACKAGE_WIFI_CUSTOM_GIT_VERSION="m-amlogic"
BR2_PACKAGE_WIFI_FW_CUSTOM_GIT_REPO_URL="git://git.myamlogic.com/platform/hardware/amlogic/wifi.git"
BR2_PACKAGE_WIFI_FW_WIFI_MODULE="bcm4354"
#BR2_PACKAGE_RTK8188EU=y
#BR2_PACKAGE_RTK8188EU_STANDALONE=y
#BR2_PACKAGE_RTK8188EU_GIT_VERSION="l-amlogic"
#BR2_PACKAGE_RTK8188EU_GIT_REPO_URL="git://git.myamlogic.com/platform/hardware/wifi/realtek/drivers/8188eu.git"
#BR2_PACKAGE_RTK8192CU=y
#BR2_PACKAGE_RTK8192CU_GIT_VERSION="8192cu"
#BR2_PACKAGE_RTK8192CU_GIT_REPO_URL="git://git.myamlogic.com/platform/hardware/wifi/realtek/drivers/8192cu.git"
#BR2_PACKAGE_RTK8192DU=y
#BR2_PACKAGE_RTK8192DU_GIT_VERSION="8192du"
#BR2_PACKAGE_RTK8192DU_GIT_REPO_URL="git://git.myamlogic.com/platform/hardware/wifi/realtek/drivers/8192du.git"
#BR2_PACKAGE_RTK8192EU=y
#BR2_PACKAGE_RTK8192EU_STANDALONE=y
#BR2_PACKAGE_RTK8192EU_GIT_VERSION="m-amlogic"
#BR2_PACKAGE_RTK8192EU_GIT_REPO_URL="git://git.myamlogic.com/platform/hardware/wifi/realtek/drivers/8192eu.git"
#BR2_PACKAGE_RTK8189ES=y
#BR2_PACKAGE_RTK8189ES_STANDALONE=y
#BR2_PACKAGE_RTK8189ES_GIT_VERSION="l-amlogic"
#BR2_PACKAGE_RTK8189ES_GIT_REPO_URL="git://git.myamlogic.com/platform/hardware/wifi/realtek/drivers/8189es.git"
#BR2_PACKAGE_RTK8189FTV=y
#BR2_PACKAGE_RTK8189FTV_STANDALONE=y
#BR2_PACKAGE_RTK8189FTV_GIT_VERSION="m-amlogic"
#BR2_PACKAGE_RTK8189FTV_GIT_REPO_URL="git://git.myamlogic.com/platform/hardware/wifi/realtek/drivers/8189ftv.git"
#BR2_PACKAGE_RTK8723BS=y
#BR2_PACKAGE_RTK8723BS_STANDALONE=y
#BR2_PACKAGE_RTK8723BS_GIT_VERSION="l-amlogic"
#BR2_PACKAGE_RTK8723BS_GIT_REPO_URL="git://git.myamlogic.com/platform/hardware/wifi/realtek/drivers/8723bs.git"
#BR2_PACKAGE_RTK8723AU=y
#BR2_PACKAGE_RTK8723AU_GIT_VERSION="8723au"
#BR2_PACKAGE_RTK8723AU_GIT_REPO_URL="git://git.myamlogic.com/platform/hardware/wifi/realtek/drivers/8723au.git"
#BR2_PACKAGE_RTK8723BU=y
#BR2_PACKAGE_RTK8723BU_STANDALONE=y
#BR2_PACKAGE_RTK8723BU_GIT_VERSION="m-amlogic"
#BR2_PACKAGE_RTK8723BU_GIT_REPO_URL="git://git.myamlogic.com/platform/hardware/wifi/realtek/drivers/8723bu.git"
#BR2_PACKAGE_RTK8811AU=y
#BR2_PACKAGE_RTK8811AU_GIT_VERSION="8811au"
#BR2_PACKAGE_RTK8811AU_GIT_REPO_URL="git://git.myamlogic.com/platform/hardware/wifi/realtek/drivers/8811au.git"
#BR2_PACKAGE_RTK8812AU=y
#BR2_PACKAGE_RTK8812AU_STANDALONE=y
#BR2_PACKAGE_RTK8812AU_GIT_VERSION="m-amlogic"
#BR2_PACKAGE_RTK8812AU_GIT_REPO_URL="git://git.myamlogic.com/platform/hardware/wifi/realtek/drivers/8812au.git"
#BR2_PACKAGE_RTK8822BU=y
#BR2_PACKAGE_RTK8822BU_STANDALONE=y
#BR2_PACKAGE_RTK8822BU_GIT_VERSION="m-amlogic"
#BR2_PACKAGE_RTK8822BU_GIT_REPO_URL="git://git.myamlogic.com/platform/hardware/wifi/realtek/drivers/8822bu.git"
BR2_PACKAGE_BRCMAP6XXX=y
BR2_PACKAGE_BRCMAP6XXX_STANDALONE=y
BR2_PACKAGE_BRCMAP6XXX_GIT_VERSION="m-amlogic"
BR2_PACKAGE_BRCMAP6XXX_GIT_REPO_URL="git://git.myamlogic.com/platform/hardware/wifi/broadcom/drivers/ap6xxx.git"
#BR2_PACKAGE_BRCMUSI=y
#BR2_PACKAGE_BRCMUSI_GIT_VERSION="kk-amlogic"
#BR2_PACKAGE_BRCMUSI_GIT_REPO_URL="git://git.myamlogic.com/platform/hardware/wifi/broadcom/drivers/usi.git"
#BR2_PACKAGE_MTK7601=y
#BR2_PACKAGE_MTK7601_GIT_VERSION="m-amlogic"
#BR2_PACKAGE_MTK7601_GIT_REPO_URL="git://git.myamlogic.com/platform/hardware/wifi/mtk/drivers/mt7601.git"
#BR2_PACKAGE_MTK7603=y
#BR2_PACKAGE_MTK7603_GIT_VERSION="m-amlogic"
#BR2_PACKAGE_MTK7603_GIT_REPO_URL="git://git.myamlogic.com/platform/hardware/wifi/mtk/drivers/mt7603.git"
#BR2_PACKAGE_AML_TVIN=y
#BR2_PACKAGE_AML_TVIN_GIT_VERSION="amlogic-3.10-bringup"
#BR2_PACKAGE_AML_TVIN_GIT_REPO_URL="git://git.myamlogic.com/linux/amlogic/tvin.git"
#BR2_PACKAGE_AML_PMU=y
#BR2_PACKAGE_AML_PMU_GIT_VERSION="master"
#BR2_PACKAGE_AML_PMU_GIT_REPO_URL="git://git.myamlogic.com/platform/hardware/amlogic/pmu.git"
#BR2_PACKAGE_AML_TOUCH=y
#BR2_PACKAGE_AML_TOUCH_GIT_VERSION="kk-amlogic"
#BR2_PACKAGE_AML_TOUCH_GIT_REPO_URL="git://git.myamlogic.com/platform/hardware/amlogic/touch.git"
#BR2_PACKAGE_MALI_EXAMPLES=y
#BR2_PACKAGE_AML_NAND=y
#BR2_PACKAGE_AML_NAND_STANDALONE=y
#BR2_PACKAGE_AML_NAND_VERSION="amlogic-nand"
#BR2_PACKAGE_AML_NAND_GIT_URL="git://git.myamlogic.com/platform/hardware/amlogic/nand.git"
BR2_PACKAGE_AML_UTIL=y
#BR2_PACKAGE_AML_THERMAL=y
#BR2_PACKAGE_AML_THERMAL_URL="git://git.myamlogic.com/platform/hardware/amlogic/thermal.git"
#BR2_PACKAGE_AML_THERMAL_VERSION="l-amlogic"
BR2_TARGET_UBOOT=y
BR2_TARGET_UBOOT_CUSTOM_GIT=y
BR2_TARGET_UBOOT_CUSTOM_REPO_URL="git://git.myamlogic.com/uboot.git"
BR2_TARGET_UBOOT_CUSTOM_REPO_VERSION="next-2015-dev"
BR2_TARGET_UBOOT_BOARDNAME="gxb_p200_v1"
BR2_TARGET_UBOOT_AMLOGIC_2015=y
BR2_TARGET_UBOOT_PLATFORM="gxb"
#BR2_PACKAGE_AML_AF_ALG=y
#BR2_PACKAGE_AML_AF_ALG_GIT_URL="git://git.myamlogic.com/vendor/amlogic/external/af_alg.git"
#BR2_PACKAGE_AML_AF_ALG_VERSION="amlogic"
```

## buildroot/configs/mesongxb_p201_light_defconfig
```kconfig
# Mirrors and Download locations
BR2_BACKUP_SITE="http://openlinux.amlogic.com:8000/download/GPL_code_release/ThirdParty"
# Architecture
BR2_aarch64=y
BR2_ARM_ENABLE_NEON=y
BR2_ARM_FPU_NEON=y
BR2_TOOLCHAIN_EXTERNAL_LINARO_AARCH64_201409=y
BR2_DEPRECATED=y
BR2_TOOLCHAIN_EXTERNAL=y
#BR2_ENABLE_DEBUG=y
BR2_PACKAGE_BUSYBOX_SHOW_OTHERS=y
BR2_PACKAGE_HOST_GDB=y
BR2_PACKAGE_ALSA_UTILS=y
BR2_PACKAGE_OPENSSL=y
BR2_PACKAGE_OPENSSL_BIN=y
BR2_PACKAGE_OPENSSL_ENGINES=y
BR2_PACKAGE_VIM=y
BR2_TARGET_ROOTFS_CPIO=y
BR2_TARGET_ROOTFS_CPIO_GZIP=y
BR2_TARGET_ROOTFS_CPIO_UIMAGE=y
BR2_TARGET_ROOTFS_INITRAMFS_LIST="board/amlogic/mesongxb_p201/initramfs/ramfslist"
BR2_TARGET_ROOTFS_EXT2=y
BR2_TARGET_ROOTFS_EXT2_4=y
BR2_TARGET_ROOTFS_EXT2_BLOCKS=1048576
BR2_TARGET_ROOTFS_TAR_GZIP=y
BR2_ROOTFS_DEVICE_CREATION_DYNAMIC_MDEV=y
BR2_ROOTFS_OVERLAY="board/amlogic/mesongxb_p201/rootfs/"
BR2_LINUX_KERNEL=y
BR2_LINUX_KERNEL_CUSTOM_GIT=y
BR2_LINUX_KERNEL_CUSTOM_REPO_URL="git://git.myamlogic.com/kernel/common.git"
BR2_LINUX_KERNEL_CUSTOM_REPO_VERSION="amlogic-3.14-dev"
BR2_LINUX_KERNEL_DEFCONFIG="meson64"
BR2_TARGET_BOARD_PLATFORM="meson8"
BR2_LINUX_KERNEL_IMAGE_LOADADDR="0x1008000"
BR2_LINUX_KERNEL_PATCH="linux/amlogic-3.14"
BR2_LINUX_KERNEL_DTS_SUPPORT=y
BR2_LINUX_KERNEL_USE_INTREE_DTS=y
BR2_LINUX_KERNEL_INTREE_DTS_NAME="gxbb_p201"
BR2_LINUX_KERNEL_AMLOGIC_DTD=y
BR2_LINUX_KERNEL_ANDROID_FORMAT=y
BR2_LINUX_KERNEL_IMAGE=y
BR2_TARGET_UBOOT=y
BR2_TARGET_UBOOT_CUSTOM_GIT=y
BR2_TARGET_UBOOT_CUSTOM_REPO_URL="git://git.myamlogic.com/uboot.git"
BR2_TARGET_UBOOT_CUSTOM_REPO_VERSION="next-2015-dev"
BR2_TARGET_UBOOT_BOARDNAME="gxb_p201_v1"
BR2_PACKAGE_AML_UBOOT_CUSTOMER=y
BR2_PACKAGE_AML_UBOOT_CUSTOMER_GIT_REPO_URL="git://git.myamlogic.com/uboot/customer.git"
BR2_PACKAGE_AML_UBOOT_CUSTOMER_GIT_VERSION="next"
BR2_TARGET_UBOOT_AMLOGIC_2015=y
BR2_TARGET_UBOOT_PLATFORM="gxb"
#BR2_PACKAGE_AML_AF_ALG=y
#BR2_PACKAGE_AML_AF_ALG_GIT_URL="git://git.myamlogic.com/vendor/amlogic/external/af_alg.git"
#BR2_PACKAGE_AML_AF_ALG_VERSION="amlogic"
```
